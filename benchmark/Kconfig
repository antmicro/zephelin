## benchmark/Kconfig
```kconfig
# Copyright (c) 2026 Analog Devices, Inc.
# Copyright (c) 2026 Antmicro <www.antmicro.com>
#
# SPDX-License-Identifier: Apache-2.0

config ZPL_BENCHMARK_ITERS
	int "Benchmark iterations"
	default 10

config ZPL_BENCHMARK_MAGIC
	string "Benchmark magic sent before every result"
	default "BENCHMARK RESULT"

choice
	prompt "Zephelin benchmark to run"
	default ZPL_BENCHMARK_RUN_DHRYSTONE

config ZPL_BENCHMARK_RUN_DHRYSTONE
	bool "Dhrystone Zephelin benchmark"
	help
		Synthetic benchmark for integer operations. Doesn't rely on any Zephyr features.

config ZPL_BENCHMARK_RUN_BASIC
	bool "Basic Zephelin benchmark (a very inefficient dot product implementaton)"
	help
		Based on an inefficient dot product implementation. Uses ZPL scopes for tracing.

config ZPL_BENCHMARK_RUN_THREADS
	bool "Threads-based Zephelin benchmark"
	help
		Features multiple threads performing a dummy operation on a single resource. Uses Zephyr's mutexes and semaphores.

config ZPL_BENCHMARK_RUN_TFLITE
	bool "TFLite-based Zephelin benchmark"
	help
		Performs inference using a simple TFLite model. Uses ZPL scopes and model tracing.

endchoice

source "Kconfig.zephyr"
```

## benchmark/sample.yaml
```yaml
# Copyright (c) 2026 Analog Devices, Inc.
# Copyright (c) 2026 Antmicro <www.antmicro.com>
#
# SPDX-License-Identifier: Apache-2.0

sample:
  description: Benchmark sample
  name: benchmark sample
common:
  tags: benchmark
tests:
  bench.dhry:
    harness: robot
    harness_config:
      robot_testsuite: bench.robot
  bench.dhry.instr:
    harness: robot
    harness_config:
      robot_testsuite: bench.robot
    extra_args: EXTRA_CONF_FILE=instr_tracing.conf
    extra_configs:
      - CONFIG_ZPL_BENCHMARK_RUN_DHRYSTONE=y
  bench.dhry.tracing:
    harness: robot
    harness_config:
      robot_testsuite: bench.robot
    extra_args: EXTRA_CONF_FILE=tracing.conf
    extra_configs:
      - CONFIG_ZPL_BENCHMARK_RUN_DHRYSTONE=y
  bench.dhry.zpl:
    harness: robot
    harness_config:
      robot_testsuite: bench.robot
    extra_args: EXTRA_CONF_FILE=zpl.conf
    extra_configs:
      - CONFIG_ZPL_BENCHMARK_RUN_DHRYSTONE=y

  bench.basic:
    harness: robot
    harness_config:
      robot_testsuite: bench.robot
    extra_configs:
      - CONFIG_ZPL_BENCHMARK_RUN_BASIC=y
  bench.basic.instr:
    harness: robot
    harness_config:
      robot_testsuite: bench.robot
    extra_args: EXTRA_CONF_FILE=instr_tracing.conf
    extra_configs:
      - CONFIG_ZPL_BENCHMARK_RUN_BASIC=y
  bench.basic.tracing:
    harness: robot
    harness_config:
      robot_testsuite: bench.robot
    extra_args: EXTRA_CONF_FILE=tracing.conf
    extra_configs:
      - CONFIG_ZPL_BENCHMARK_RUN_BASIC=y
  bench.basic.zpl:
    harness: robot
    harness_config:
      robot_testsuite: bench.robot
    extra_args: EXTRA_CONF_FILE=zpl.conf
    extra_configs:
      - CONFIG_ZPL_BENCHMARK_RUN_BASIC=y

  bench.threads:
    harness: robot
    harness_config:
      robot_testsuite: bench.robot
    extra_configs:
      - CONFIG_ZPL_BENCHMARK_RUN_THREADS=y
  bench.threads.tracing:
    harness: robot
    harness_config:
      robot_testsuite: bench.robot
    extra_args: EXTRA_CONF_FILE=tracing.conf
    extra_configs:
      - CONFIG_ZPL_BENCHMARK_RUN_THREADS=y

  bench.tflite:
    harness: robot
    harness_config:
      robot_testsuite: bench.robot
    extra_args: EXTRA_CONF_FILE=tflite.conf
    extra_configs:
      - CONFIG_ZPL_BENCHMARK_RUN_TFLITE=y
  bench.tflite.zpl:
    harness: robot
    harness_config:
      robot_testsuite: bench.robot
    extra_args: EXTRA_CONF_FILE=tflite.conf;zpl.conf
    extra_configs:
      - CONFIG_ZPL_BENCHMARK_RUN_TFLITE=y
  bench.tflite.tracing:
    harness: robot
    harness_config:
      robot_testsuite: bench.robot
    extra_args: EXTRA_CONF_FILE=tflite.conf;tracing.conf
    extra_configs:
      - CONFIG_ZPL_BENCHMARK_RUN_TFLITE=y
```

## samples/common/tflm/Kconfig
```kconfig
# Copyright (c) 2025 Analog Devices, Inc.
# Copyright (c) 2025 Antmicro <www.antmicro.com>
#
# SPDX-License-Identifier: Apache-2.0

config ZPL_SAMPLE_TFLM_NUM_ITERS
	int "Number of inference iterations to run in the program"
	default 10

config ZPL_SAMPLE_TFLM_MODEL
	string "TFLite Micro model to use"
	default "magic-wand"

config ZPL_SAMPLE_TFLM_BUFFER_SIZE
	int "TFLite Micro buffer size in kilobytes"
	default 40
```

## samples/common/tvm/Kconfig
```kconfig
# Copyright (c) 2025 Analog Devices, Inc.
# Copyright (c) 2025 Antmicro <www.antmicro.com>
#
# SPDX-License-Identifier: Apache-2.0

config ZPL_SAMPLE_TVM_QUANTIZED_MODEL
	bool "Whether to also prepare quantized TVM model"

config ZPL_SAMPLE_TVM_HEAP_SIZE
	int "Size of the TVM heap in KB"
	default 90
```

## samples/multi_machine/two_models/node_1/Kconfig
```kconfig
# Copyright (c) 2026 Analog Devices, Inc.
# Copyright (c) 2026 Antmicro <www.antmicro.com>
#
# SPDX-License-Identifier: Apache-2.0

rsource "../../../common/tflm/Kconfig"

source "Kconfig.zephyr"

config ZPL_SAMPLE_APP_STARTUP_DELAY_MS
int "Application startup delay in milliseconds"
default 0
```

## samples/profiling/memory_profiling/Kconfig
```kconfig
# Copyright (c) 2025 Analog Devices, Inc.
# Copyright (c) 2025 Antmicro <www.antmicro.com>
#
# SPDX-License-Identifier: Apache-2.0

config ZPL_SAMPLE_RUNTIME_CONF_PROFILING
	bool "Runtime runtime profiling configuration from C API"
	help
	  Say 'Y' if you want to enable runtime configuration threading features.

source "Kconfig.zephyr"
```

## samples/profiling/tflm_instrumentation/boards/max32690fthr_max32690_m4.conf
```kconfig
CONFIG_INSTRUMENTATION_MODE_CALLGRAPH_TRACE_BUFFER_SIZE=64000
CONFIG_UDC_MAX32_MAX_QMESSAGES=64
CONFIG_UDC_MAX32_THREAD_PRIORITY=-5
CONFIG_UDC_MAX32_THREAD_STACK_SIZE=4096
```

## samples/profiling/trace_transport/boards/max78002evkit_max78002_m4.conf
```kconfig
CONFIG_INSTRUMENTATION_MODE_CALLGRAPH_TRACE_BUFFER_SIZE=38400
CONFIG_INSTRUMENTATION_DYNAMIC_TRIGGER=n
```

## samples/profiling/trace_transport/sample.yaml
```yaml
# Copyright (c) 2026 Analog Devices, Inc.
# Copyright (c) 2026 Antmicro <www.antmicro.com>
#
# SPDX-License-Identifier: Apache-2.0

sample:
  description: Hello World TensorFlow instrumentation sample
  name: hello world tensorflow instrumentation
common:
  tags: tensorflow profiling
  platform_allow:
    - max78002evkit/max78002/m4
  modules:
    - tflite-micro
tests:
  sample.tensorflow.trace.transport.instrumentation.robot:
    extra_configs:
    - CONFIG_INSTRUMENTATION_RECURSIVE_EXCLUDE=y
    - CONFIG_INSTRUMENTATION_RECURSIVE_EXCLUDE_LIST="sys_clock_isr"
    harness: robot
    harness_config:
      robot_testsuite: instrumentation.robot
```

## zpl/Kconfig
```kconfig
# Copyright (c) 2025 Analog Devices, Inc.
# Copyright (c) 2025 Antmicro <www.antmicro.com>
#
# SPDX-License-Identifier: Apache-2.0

rsource "profilers/Kconfig"
rsource "backends/Kconfig"
rsource "scopes/Kconfig"
rsource "conf/Kconfig"
rsource "conf/Kconfig.mute_traces"

config ZPL
	bool "Support for Zephelin"
	help
	  Say 'Y' if you want to enable support for Zephelin, the Zephyr AI
	  Profiling Library.

config ZPL_TRACE
	bool "Support for integration with Zephyr tracing subsystem"
	select TRACING

config ZPL_INSTRUMENTATION
	bool "Enables instrumentation subsystem"
	select INSTRUMENTATION
	select INSTRUMENTATION_CTF_TIMER
	help
	  Enables instrumentation subsystem and selects proper time measurements mechanism,
	  as well as CTF trace format.

choice
	prompt "Zephelin trace format"
	default ZPL_TRACE_FORMAT_CTF if ZPL_INSTRUMENTATION
	default ZPL_TRACE_FORMAT_PLAINTEXT
	depends on ZPL_TRACE

config ZPL_TRACE_FORMAT_PLAINTEXT
	bool "Plaintext format for Zephelin trace"

config ZPL_TRACE_FORMAT_CTF
	bool "CTF format for Zephelin trace"

endchoice

choice TRACING_FORMAT_CHOICE
	default TRACING_TEST if ZPL_TRACE_FORMAT_PLAINTEXT
	default TRACING_CTF if ZPL_TRACE_FORMAT_CTF
endchoice

config ZPL_TRACE_CTF_MAX_STR_LEN
	int "Maximum string length for CTF events"
	default 20
	depends on ZPL_TRACE_FORMAT_CTF

config ZPL_TRACE_CTF_MAX_LONG_STR_LEN
	int "Maximum long string length for CTF events"
	default 60
	depends on ZPL_TRACE_FORMAT_CTF

config ZPL_INTERNALS_INSTRUMENTATION
	bool "Instrumentation of Zephelin internal functions"
	depends on ZPL_INSTRUMENTATION
	help
	  Say 'Y' if you want to enable instrumentation of Zephelin internal function,
	  otherwise all Zephelin files will be excluded from instrumentation.
	depends on INSTRUMENTATION

config ZPL_AUTORUN_INIT
	bool "Runs zpl_init automatically within SYS_INIT"
	default y
	depends on ZPL

choice
	prompt "Sets SYS_INIT initialization level for call of zpl_init"
	default ZPL_INIT_LVL_APPLICATION
	depends on ZPL_AUTORUN_INIT

config ZPL_INIT_LVL_EARLY
	bool "Sets level to EARLY"

config ZPL_INIT_LVL_PRE_KERNEL_1
	bool "Sets level to PRE_KERNEL_1"

config ZPL_INIT_LVL_PRE_KERNEL_2
	bool "Sets level to PRE_KERNEL_2"

config ZPL_INIT_LVL_POST_KERNEL
	bool "Sets level to POST_KERNEL"

config ZPL_INIT_LVL_APPLICATION
	bool "Sets level to APPLICATION"

config ZPL_INIT_LVL_SMP
	bool "Sets level to SMP"

endchoice

config ZPL_INIT_PRIO
	int "Sets SYS_INIT priority for call of zpl_init"
	default 1
	depends on ZPL_AUTORUN_INIT

module = ZPL
module-str = Zephelin
source "subsys/logging/Kconfig.template.log_config"
```

## zpl/backends/Kconfig
```kconfig
# Copyright (c) 2025 Analog Devices, Inc.
# Copyright (c) 2025 Antmicro <www.antmicro.com>
#
# SPDX-License-Identifier: Apache-2.0

choice
	prompt "Zephelin trace backend"
	default ZPL_TRACE_BACKEND_UART
	depends on ZPL_TRACE

config ZPL_TRACE_BACKEND_UART
	bool "UART backend for Zephelin"
	select UART

config ZPL_TRACE_BACKEND_TRIVIAL_UART
	bool "Trivial UART backend for Zephelin"
	select UART

config ZPL_TRACE_BACKEND_USB
	bool "USB backend for Zephelin"
	select GPIO
	# Selecting HWINFO should be dropped after this issue is resolved:
	# https://github.com/zephyrproject-rtos/zephyr/issues/93266
	select HWINFO
	select TRACING_HANDLE_HOST_CMD
	select USB_DEVICE_STACK_NEXT
	select USBD_BOS_SUPPORT
	select USBD_VREQ_SUPPORT
	depends on TRACING_ASYNC

config ZPL_TRACE_BACKEND_DEBUGGER
	bool "Debugger backend for Zephelin"

endchoice

config TRACING_BACKEND_NAME
	string
	default "tracing_backend_uart" if ZPL_TRACE_BACKEND_UART
	default "tracing_backend_trivial_uart" if ZPL_TRACE_BACKEND_TRIVIAL_UART
	default "tracing_backend_usb" if ZPL_TRACE_BACKEND_USB
	default "tracing_backend_ram" if ZPL_TRACE_BACKEND_DEBUGGER

choice TRACING_BACKEND_CHOICE
	default TRACING_BACKEND_UART if ZPL_TRACE_BACKEND_UART
	default TRACING_BACKEND_USB if ZPL_TRACE_BACKEND_USB
	default TRACING_BACKEND_RAM if ZPL_TRACE_BACKEND_DEBUGGER
endchoice
```

## zpl/profilers/tvm/Kconfig
```kconfig
# Copyright (c) 2025 Analog Devices, Inc.
# Copyright (c) 2025 Antmicro <www.antmicro.com>
#
# SPDX-License-Identifier: Apache-2.0

config ZPL_TVM_EVENTS
	bool "Enables micro TVM events"
	depends on ZPL

config ZPL_TVM_PROFILER
	bool "Enables micro TVM profiler"
	depends on ZPL
	select ZPL_TVM_EVENTS

config ZPL_TVM_PROFILER_MAX_EVENTS
	int "Max number of buffered event"
	default 32
	depends on ZPL_TVM_PROFILER

config ZPL_TVM_PROFILER_DELAYED_EMISSION
	bool "Buffer and delay TVM profiling events"
	depends on ZPL_TVM_PROFILER
	help
	  Instead of emitting a trace event on every TVM operator boundary,
	  store the timestamps in memory and emit all the events at once when
	  the inference is done. This keeps the tracing overhead out of the
	  measured inference.
```
