## CMakeLists.txt
```
# Copyright (c) 2026 Analog Devices, Inc.
# Copyright (c) 2026 Antmicro <www.antmicro.com>
#
# SPDX-License-Identifier: Apache-2.0

cmake_minimum_required(VERSION 3.20.0)

include(${CMAKE_CURRENT_SOURCE_DIR}/../../common/boards.cmake)

find_package(Zephyr REQUIRED HINTS $ENV{ZEPHYR_BASE})
project(app)
target_sources(app PRIVATE src/main.c)
```

## Kconfig
```
# Copyright (c) 2025-2026 Analog Devices, Inc.
# Copyright (c) 2025-2026 Antmicro <www.antmicro.com>
#
# SPDX-License-Identifier: Apache-2.0

config ZPL_SAMPLE_SIMPLE_COUNTER_CLOCK
	bool "Use simple counter instead as a custom clock"
	help
	  Say 'Y' if you want to enable runtime configuration threading features.

source "Kconfig.zephyr"
```

## sample.yaml
```
# Copyright (c) 2026 Analog Devices, Inc.
# Copyright (c) 2026 Antmicro <www.antmicro.com>
#
# SPDX-License-Identifier: Apache-2.0

sample:
  name: custom_clock
common:
  tags: basic
  platform_exclude:
    - mpfs_icicle/polarfire/u54/smp
tests:
  sample.trace.custom_clock.timings.robot:
    harness: robot
    harness_config:
      robot_testsuite: custom_clock_simple.robot
    extra_configs:
      - CONFIG_ZPL_SCOPE_MARKING=y
      - CONFIG_PRINTK=n
      - CONFIG_TIMING_FUNCTIONS=y
  sample.trace.custom_clock.sensor_clock_system.robot:
    harness: robot
    harness_config:
      robot_testsuite: custom_clock_simple.robot
    extra_configs:
      - CONFIG_ZPL_SCOPE_MARKING=y
      - CONFIG_PRINTK=n
      - CONFIG_SENSOR=y
      - CONFIG_SENSOR_ASYNC_API=y
      - CONFIG_SENSOR_CLOCK_SYSTEM=y
  sample.trace.custom_clock.sensor_clock_counter.robot:
    harness: robot
    harness_config:
      robot_testsuite: custom_clock_simple.robot
    platform_allow:
      - stm32f429i_disc1/stm32f429xx
      - max32650fthr
    extra_configs:
      - CONFIG_ZPL_SCOPE_MARKING=y
      - CONFIG_PRINTK=n
      - CONFIG_SENSOR=y
      - CONFIG_COUNTER=y
      - CONFIG_SENSOR_ASYNC_API=y
      - CONFIG_SENSOR_CLOCK_COUNTER=y
  sample.trace.custom_clock.zephyr_events.robot:
    harness: robot
    harness_config:
      robot_testsuite: custom_clock_zephyr_events.robot
    extra_configs:
      - CONFIG_ZPL_SAMPLE_SIMPLE_COUNTER_CLOCK=y
      - CONFIG_ZPL_SCOPE_MARKING=y
      - CONFIG_ZPL_MEMORY_PROFILING=y
      - CONFIG_ZPL_MEMORY_PROFILING_INTERVAL=10
      - CONFIG_ZPL_MEMORY_PROFILING_THREAD_PRIORITY=-1
      - CONFIG_PRINTK=n
  sample.trace.custom_clock.instrumentation.robot:
    harness: robot
    harness_config:
      robot_testsuite: custom_clock_instrumentation.robot
    extra_configs:
      - CONFIG_ZPL_INSTRUMENTATION=y
      - CONFIG_PRINTK=y
      - CONFIG_INSTRUMENTATION_DYNAMIC_TRIGGER=n
      - CONFIG_INSTRUMENTATION_TRIGGER_FUNCTION="nested1"
      - CONFIG_INSTRUMENTATION_STOPPER_FUNCTION="nested1"
```

## prj.conf
```kconfig
CONFIG_ZPL=y
CONFIG_ZPL_TRACE=y
CONFIG_ZPL_CONFIGURABLE_TIMESTAMP_CLOCK=y
CONFIG_ZPL_TRACE_FORMAT_CTF=y
CONFIG_ZPL_AUTORUN_INIT=n

CONFIG_TRACING_SYNC=y
CONFIG_SYS_HEAP_ARRAY_SIZE=4

CONFIG_BOOT_BANNER=n
```

## src/main.c
```c
/*
 * Copyright (c) 2026 Analog Devices, Inc.
 * Copyright (c) 2026 Antmicro <www.antmicro.com>
 *
 * SPDX-License-Identifier: Apache-2.0
 */

#include <zephyr/kernel.h>
#include <zpl.h>
#include <zpl/time.h>

#if defined(CONFIG_SENSOR_CLOCK)
#include <zephyr/drivers/sensor_clock.h>

static uint64_t cycles_get(void)
{
	uint64_t cycles;

	sensor_clock_get_cycles(&cycles);
	return cycles;
}

static uint64_t timestamp_get(uint64_t cycles)
{
	return sensor_clock_cycles_to_ns(cycles);
}
#elif !defined(CONFIG_ZPL_SAMPLE_SIMPLE_COUNTER_CLOCK) && \
  defined(CONFIG_TIMING_FUNCTIONS) && \
  !defined(CONFIG_INSTRUMENTATION)
#include <zephyr/timing/timing.h>
#include <zephyr/timing/types.h>

uint64_t cycles_get(void)
{
	timing_t start = 0;
	timing_t now = timing_counter_get();

	return timing_cycles_get(&start, &now);
}
static uint64_t timestamp_get(uint64_t cycles)
{
	return timing_cycles_to_ns(cycles);
}

int timing_init_sys(void)
{
	timing_init();
	timing_start();
	return 0;
}
SYS_INIT(timing_init_sys, APPLICATION, 0);
#else  /* CONFIG_SENSOR_CLOCK */
static uint64_t counter = 1;
static uint64_t cycles_get(void)
{
	return counter++;
}

static uint64_t timestamp_get(uint64_t cycles)
{
	return cycles;
}
#endif /* CONFIG_SENSOR_CLOCK */

#ifdef CONFIG_INSTRUMENTATION
#define sys_trace_named_event(fmt, ...)            \
	ZPL_DISABLE_INSTRUMENTATION {                  \
		printk(fmt" %llu\n", zpl_timestamp_get()); \
	}

#define PRINTK_SCOPE(name, value)                                                  \
	ZPL_DISABLE_INSTRUMENTATION { printk(name"_enter %llu\n", zpl_cycles_get()); } \
	value;                                                                         \
	ZPL_DISABLE_INSTRUMENTATION { printk(name"_exit %llu\n", zpl_cycles_get()); }
#else /* CONFIG_INSTRUMENTATION */
#define PRINTK_SCOPE(fmt, value) value
#endif /* CONFIG_INSTRUMENTATION */

static zpl_clock_t simple_clock = {
	.cycles_get = cycles_get,
	.timestamp_get = timestamp_get,
};

ZPL_CODE_SCOPE_DEFINE(nested_scope1, true);
ZPL_CODE_SCOPE_DEFINE(nested_scope2, true);

static __noinline void nested2(void)
{
	ZPL_MARK_CODE_SCOPE(nested_scope2) {
		PRINTK_SCOPE("nested2", sys_trace_named_event("top", 0, 0));
	}
}

__noinline void nested1(void)
{
	ZPL_MARK_CODE_SCOPE(nested_scope1) {
		PRINTK_SCOPE("nested2", nested2());
	}
}

int main(void)
{
	zpl_clock_set(simple_clock);
	zpl_init();

	k_sleep(K_MSEC(10));

	for (int i = 0; i < 10; i++) {
		sys_trace_named_event("tick", i, 0);
	}

	k_sleep(K_MSEC(10));

	nested1();

	return 0;
}
```
