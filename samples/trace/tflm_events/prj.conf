## CMakeLists.txt
```
# Copyright (c) 2025 Analog Devices, Inc.
# Copyright (c) 2025 Antmicro <www.antmicro.com>
#
# SPDX-License-Identifier: Apache-2.0

cmake_minimum_required(VERSION 3.20.0)

include(${CMAKE_CURRENT_SOURCE_DIR}/../common/boards.cmake)

find_package(Zephyr REQUIRED HINTS $ENV{ZEPHYR_BASE})
project(app)
target_sources(app PRIVATE src/main.c)
```

## sample.yaml
```
sample:
  name: simple
common:
  tags: profiling
  harness: console
  harness_config:
    type: one_line
    regex:
      - "zpl_tflm_enter_event"
tests:
  sample.trace.tflm_events.plaintext:
    tags: profiling
  sample.trace.tflm_events.plaintext.robot:
    tags: profiling
    harness: robot
    harness_config:
      robot_testsuite: tflm_events_plaintext.robot
  sample.trace.tflm_events.ctf.robot:
    tags: profiling
    extra_configs:
      - CONFIG_TRACING_BUFFER_SIZE=4096
      - CONFIG_ZPL_TRACE_FORMAT_CTF=y
      - CONFIG_BOOT_BANNER=n
      - CONFIG_PRINTK=n
    harness: robot
    harness_config:
      robot_testsuite: tflm_events_ctf.robot
```

## prj.conf
```kconfig
CONFIG_ZPL=y
CONFIG_ZPL_TRACE=y
CONFIG_ZPL_TFLM_EVENTS=y
```

## src/main.c
```c
/*
 * Copyright (c) 2025 Analog Devices, Inc.
 * Copyright (c) 2025 Antmicro <www.antmicro.com>
 *
 * SPDX-License-Identifier: Apache-2.0
 */

#include <zpl/lib.h>
#include <zpl/tflm_events.h>
#include <zephyr/kernel.h>

int main(void)
{
	const char *tflm_op_tag = "TFLM_OP";

	zpl_init();

	zpl_emit_tflm_enter_event(k_cycle_get_32(), 0, 0, tflm_op_tag, 0, 1);
	zpl_emit_tflm_exit_event(k_cycle_get_32(), 0, 0, tflm_op_tag, 2, 3);

	return 0;
}
```
