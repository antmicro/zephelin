## CMakeLists.txt
```
cmake_minimum_required(VERSION 3.20.0)

find_package(Zephyr REQUIRED HINTS $ENV{ZEPHYR_BASE})
project(app)
target_sources(app PRIVATE src/main.c)
```

## sample.yaml
```
sample:
  name: marking_code_scopes
common:
  tags: profiling
tests:
  sample.trace.marking_code_scopes.plaintext.robot:
    tags: profiling
    harness: robot
    harness_config:
      robot_testsuite: marking_code_scopes_plaintext.robot
    extra_configs:
      - CONFIG_ZPL_RUNTIME_CONFIG_UART=y
  sample.trace.marking_code_scopes.ctf.robot:
    tags: profiling
    harness: robot
    harness_config:
      robot_testsuite: marking_code_scopes_ctf.robot
    extra_configs:
      - CONFIG_ZPL_RUNTIME_CONFIG_UART=n
      - CONFIG_ZPL_TRACE_FORMAT_CTF=y
      - CONFIG_BOOT_BANNER=n
      - CONFIG_PRINTK=n
```

## prj.conf
```kconfig
CONFIG_ZPL=y
CONFIG_ZPL_TRACE=y
CONFIG_ZPL_SCOPE_MARKING=y
```

## src/main.c
```c
/*
 * Copyright (c) 2025 Analog Devices, Inc.
 * Copyright (c) 2025 Antmicro <www.antmicro.com>
 *
 * SPDX-License-Identifier: Apache-2.0
 */

#include <zephyr/kernel.h>
#include <zpl/lib.h>

ZPL_CODE_SCOPE_DEFINE(code_scope1, false);
ZPL_CODE_SCOPE_DEFINE(code_scope2, false);
ZPL_CODE_SCOPE_DEFINE(code_scope3, true);
ZPL_CODE_SCOPE_DEFINE(code_scope4, true);

void test_function(int counter)
{
	printk("Test: %d\n", counter);
	ZPL_MARK_CODE_SCOPE(code_scope1) {
		printk("Inner test: %d\n", counter);
		k_sleep(K_MSEC(100));
	}
}

void test_function2(int counter)
{
	zpl_code_scope_enter(code_scope2);

		printk("Inside of scope test_function2 %d\n", counter);
		k_sleep(K_MSEC(100));

	zpl_code_scope_exit(code_scope2);
}

void test_recurrent(int counter)
{
	printk("Recurrent: %d\n", counter);
	ZPL_MARK_CODE_SCOPE(code_scope4) {
		k_sleep(K_MSEC(100));
		if (counter == 0) return;
		test_recurrent(counter - 1);
	}
}

int main(void)
{
	zpl_init();
	k_sleep(K_MSEC(1000));
	for (int i = 0; i < 10; i++) {
		ZPL_MARK_CODE_SCOPE(code_scope3) {
			test_function(i);
		}
		k_sleep(K_MSEC(100));
	}

	for (int i = 0; i < 5; i++) {
		test_function2(i);
		k_sleep(K_MSEC(100));
	}

	test_recurrent(5);

	return 0;
}
```
