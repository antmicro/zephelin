## CMakeLists.txt
```
# Copyright (c) 2026 Analog Devices, Inc.
# Copyright (c) 2026 Antmicro <www.antmicro.com>
#
# SPDX-License-Identifier: Apache-2.0

cmake_minimum_required(VERSION 3.20.0)

find_package(Zephyr REQUIRED HINTS $ENV{ZEPHYR_BASE})
project(app)
target_sources(app PRIVATE src/main.cpp)

add_subdirectory(${CMAKE_CURRENT_SOURCE_DIR}/../../../common/tflm ${CMAKE_CURRENT_BINARY_DIR}/tflm)
target_link_libraries(app PRIVATE tflm_model)
```

## sample.yaml
```
# Copyright (c) 2026 Analog Devices, Inc.
# Copyright (c) 2026 Antmicro <www.antmicro.com>
#
# SPDX-License-Identifier: Apache-2.0

sample:
  name: same_app_on_two_SoCs
common:
  harness: robot
  sysbuild: true
  tags: multi_machine
  platform_allow:
    - max32650fthr

tests:
  sample.trace.two_models.boot:
    harness_config:
      robot_testsuite: tflm_dual_events_plaintext.robot

  sample.multi.staggered_boot:
    harness_config:
      robot_testsuite: tflm_staggered_boot.robot
    extra_args:
      - node_1_CONFIG_ZPL_SAMPLE_APP_STARTUP_DELAY_MS:STRING=2000
```

## prj.conf
```kconfig
CONFIG_ZPL=y
CONFIG_ZPL_TRACE=y
CONFIG_ZPL_CONFIGURABLE_TIMESTAMP_CLOCK=y
CONFIG_ZPL_TFLM_PROFILER=y

CONFIG_SYS_HEAP_ARRAY_SIZE=4

CONFIG_BOOT_BANNER=n

CONFIG_TRACING_BUFFER_SIZE=4096
CONFIG_TRACING_SYNC=y
CONFIG_MAIN_STACK_SIZE=3072

CONFIG_TEST_RANDOM_GENERATOR=y
CONFIG_TENSORFLOW_LITE_MICRO=y
CONFIG_ZPL_SAMPLE_TFLM_BUFFER_SIZE=20
CONFIG_CPP=y
CONFIG_STD_CPP17=y

CONFIG_LOG=y
CONFIG_ZPL_LOG_LEVEL_INF=y
```

## src/main.cpp
```c
/*
 * Copyright (c) 2026 Analog Devices, Inc.
 * Copyright (c) 2026 Antmicro <www.antmicro.com>
 *
 * SPDX-License-Identifier: Apache-2.0
 */

extern "C" {
#include <zpl.h>
#include <zpl/time.h>

#include <zephyr/kernel.h>
#include <zephyr/random/random.h>
#include <generated/model0_data.h>
}
#include <tflm_model.h>
#define N_SAMPLES 2
#define INPUT_SHAPE_0 128
#define INPUT_SHAPE_1 3
#define INPUT_MIN_VAL -2040.0f
#define INPUT_MAX_VAL 2040.0f

#define EXTERNAL_CLOCK_ADDR 0x400FFFF0

using namespace tflm;

static uint64_t cycles_get(void)
{
    return (uint64_t)*(volatile uint32_t *)EXTERNAL_CLOCK_ADDR;
}

static uint64_t timestamp_get(uint64_t cycles)
{
    return cycles * 1000ULL;
}

static zpl_clock_t sensor_clock = {
	.cycles_get = cycles_get,
	.timestamp_get = timestamp_get,
};

void rand_input(float model_input[][INPUT_SHAPE_1]);

int main(void)
{
	float __attribute((aligned(32))) model_input[INPUT_SHAPE_0][INPUT_SHAPE_1];
	int status = 0;

	zpl_clock_set(sensor_clock);

	#ifdef CONFIG_ZPL_TRACE_BACKEND_USB
	k_sleep(K_MSEC(500));
	#endif

	model_init();
	status = model_load(model0_data);
	if (status) {
		printk("Model load failed %d\n", status);
		return 1;
	}
	for (int batch_index = 0; batch_index < N_SAMPLES; ++batch_index) {
		rand_input(model_input);
		status = model_load_input((uint8_t *)model_input,
				sizeof(float) * INPUT_SHAPE_0 * INPUT_SHAPE_1);
		if (status) {
			printk("Model load input failed %d\n", status);
			break;
		}

		status = model_run();
		if (status) {
			printk("Model run failed %d\n", status);
			break;
		}
	}

	return 0;
}

void rand_input(float model_input[][INPUT_SHAPE_1])
{
	for (int i = 0; i < INPUT_SHAPE_0; ++i) {
		for (int j = 0; j < INPUT_SHAPE_1; ++j) {
			model_input[i][j] = (
					(INPUT_MAX_VAL - INPUT_MIN_VAL) *
					(float)sys_rand32_get() / (float)0xFFFFFFFF)
				+ INPUT_MIN_VAL;
		}
	}
}
```
