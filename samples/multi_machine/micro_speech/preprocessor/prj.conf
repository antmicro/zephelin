## CMakeLists.txt
```
# Copyright (c) 2026 Analog Devices, Inc.
# Copyright (c) 2026 Antmicro <www.antmicro.com>
#
# SPDX-License-Identifier: Apache-2.0

cmake_minimum_required(VERSION 3.20.0)

set(DTC_OVERLAY_FILE "${CMAKE_CURRENT_SOURCE_DIR}/../../boards/max32650fthr.overlay")

set(SIGNAL_BASE_DIR "${CMAKE_CURRENT_SOURCE_DIR}/../../../../../optional/modules/lib/tflite-micro/signal")

find_package(Zephyr REQUIRED HINTS $ENV{ZEPHYR_BASE})
project(app)

zephyr_library_include_directories(
    ${SIGNAL_BASE_DIR}/micro/kernels
    ${SIGNAL_BASE_DIR}/src
    ${CMAKE_CURRENT_SOURCE_DIR}/../data
)

zephyr_library_sources(
    ${SIGNAL_BASE_DIR}/micro/kernels/fft_auto_scale_kernel.cc
    ${SIGNAL_BASE_DIR}/micro/kernels/fft_auto_scale_common.cc
    ${SIGNAL_BASE_DIR}/micro/kernels/energy.cc
    ${SIGNAL_BASE_DIR}/micro/kernels/filter_bank.cc
    ${SIGNAL_BASE_DIR}/micro/kernels/filter_bank_log.cc
    ${SIGNAL_BASE_DIR}/micro/kernels/filter_bank_spectral_subtraction.cc
    ${SIGNAL_BASE_DIR}/micro/kernels/filter_bank_square_root.cc
    ${SIGNAL_BASE_DIR}/micro/kernels/filter_bank_square_root_common.cc
    ${SIGNAL_BASE_DIR}/micro/kernels/pcan.cc
    ${SIGNAL_BASE_DIR}/src/fft_auto_scale.cc
    ${SIGNAL_BASE_DIR}/src/energy.cc
    ${SIGNAL_BASE_DIR}/src/filter_bank.cc
    ${SIGNAL_BASE_DIR}/src/filter_bank_log.cc
    ${SIGNAL_BASE_DIR}/src/filter_bank_spectral_subtraction.cc
    ${SIGNAL_BASE_DIR}/src/filter_bank_square_root.cc
    ${SIGNAL_BASE_DIR}/src/pcan_argc_fixed.cc
    ${SIGNAL_BASE_DIR}/src/max_abs.cc
    ${SIGNAL_BASE_DIR}/src/msb_32.cc
    ${SIGNAL_BASE_DIR}/src/msb_64.cc
    ${SIGNAL_BASE_DIR}/src/log.cc
    ${SIGNAL_BASE_DIR}/src/square_root_32.cc
    ${SIGNAL_BASE_DIR}/src/square_root_64.cc
)

add_compile_definitions(IS_PREPROCESSOR)
target_sources(app PRIVATE src/main.cpp)

add_subdirectory(${CMAKE_CURRENT_SOURCE_DIR}/../../../common/tflm ${CMAKE_CURRENT_BINARY_DIR}/tflm)
target_link_libraries(app PRIVATE tflm_model)
```

## Kconfig
```
# Copyright (c) 2026 Analog Devices, Inc.
# Copyright (c) 2026 Antmicro <www.antmicro.com>
#
# SPDX-License-Identifier: Apache-2.0

rsource "../../../common/tflm/Kconfig"

source "Kconfig.zephyr"
```

## prj.conf
```kconfig
CONFIG_ZPL=y
CONFIG_ZPL_TRACE=y
CONFIG_ZPL_SCOPE_MARKING=y
CONFIG_ZPL_CONFIGURABLE_TIMESTAMP_CLOCK=y
CONFIG_ZPL_TFLM_PROFILER=y
CONFIG_ZPL_TRACE_FORMAT_CTF=y
CONFIG_ZPL_SAMPLE_TFLM_MODEL="audio_preprocessor_int8"
CONFIG_PRINTK=y

CONFIG_SYS_HEAP_ARRAY_SIZE=4

CONFIG_BOOT_BANNER=n

CONFIG_TRACING_BUFFER_SIZE=4096
CONFIG_TRACING_SYNC=y
CONFIG_MAIN_STACK_SIZE=3072

CONFIG_TENSORFLOW_LITE_MICRO=y
CONFIG_ZPL_SAMPLE_TFLM_BUFFER_SIZE=20
CONFIG_CPP=y
CONFIG_STD_CPP17=y

CONFIG_LOG=y
CONFIG_ZPL_LOG_LEVEL_INF=y

CONFIG_ZPL_AUTORUN_INIT=n
```

## src/main.cpp
```c
/*
 * Copyright (c) 2026 Analog Devices, Inc.
 * Copyright (c) 2026 Antmicro <www.antmicro.com>
 *
 * SPDX-License-Identifier: Apache-2.0
 */

#include <zephyr/kernel.h>
#include <zephyr/drivers/uart.h>
#include <zpl.h>
#include <zpl/time.h>
#include <tflm_model.h>

extern "C" {
  #include <generated/model0_data.h>
}

ZPL_CODE_SCOPE_DEFINE(send_frame, true);

#define INPUT_SHAPE 480
#define OUTPUT_SHAPE 40

static int16_t input_buffer[INPUT_SHAPE];
static int8_t model_output[OUTPUT_SHAPE];

const struct device *uart_dev = DEVICE_DT_GET(DT_NODELABEL(uart1));

#define EXTERNAL_CLOCK_ADDR 0x400FFFF0

using namespace tflm;

static uint64_t cycles_get(void)
{
	return (uint64_t)*(volatile uint32_t *)EXTERNAL_CLOCK_ADDR;
}

static uint64_t timestamp_get(uint64_t cycles)
{
    return cycles * 1000ULL;
}

static zpl_clock_t custom_clock = {
	.cycles_get = cycles_get,
	.timestamp_get = timestamp_get,
};

void generate_input();
void send_data_via_uart(int8_t data[]);

int main(void)
{
  int status = 0;
  printk("PREPROCESSOR STATRING...\n");

  zpl_clock_set(custom_clock);
  zpl_init();

  // Give micro-speech time to initialize
  k_msleep(1000);

	model_init();

	status = model_load(model0_data);
	if (status) {
		printk("Model load failed %d\n", status);
		return 1;
	}

  for(;;) {

    generate_input();

    status = model_load_input((uint8_t *)input_buffer, sizeof(int16_t) * INPUT_SHAPE);

    if (status) {
      printk("Model load input failed %d\n", status);
      return 1;
    }

    status = model_run();
    if (status) {
        printk("Model invocation failed\n");
        return 1;
    }

    status = model_get_output((uint8_t *)model_output, sizeof(model_output));
    if (status) {
        printk("Model get output failed %d\n", status);
        return 1;
    }

    send_data_via_uart(model_output);
  }

  return 0;
}

void generate_input() {
  // Put fake data into buffer
  for (int i = 0; i < INPUT_SHAPE; i++) {
    input_buffer[i] = (i % 100) * 50;
  }
}

void send_data_via_uart(int8_t data[]) {
  // Send sync header
  uart_poll_out(uart_dev, 0xAA);
  uart_poll_out(uart_dev, 0xBB);

  // Send model output
  ZPL_MARK_CODE_SCOPE(send_frame) {
    for (int i = 0; i < OUTPUT_SHAPE; ++i) {
      uart_poll_out(uart_dev, (uint8_t)data[i]);
      k_usleep(100);
    }
  }

  // Send footer
  uart_poll_out(uart_dev, '\n');

}
```
