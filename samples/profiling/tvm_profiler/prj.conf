## CMakeLists.txt
```
# Copyright (c) 2025 Analog Devices, Inc.
# Copyright (c) 2025 Antmicro <www.antmicro.com>
#
# SPDX-License-Identifier: Apache-2.0

cmake_minimum_required(VERSION 3.20.0)

include(${CMAKE_CURRENT_SOURCE_DIR}/../../common/boards.cmake)

find_package(Zephyr REQUIRED HINTS $ENV{ZEPHYR_BASE})
project(app)
target_sources(app PRIVATE src/main.c)

add_subdirectory(${CMAKE_CURRENT_SOURCE_DIR}/../../common/tvm ${CMAKE_CURRENT_BINARY_DIR}/tvm)
target_link_libraries(app PRIVATE tvm_model)
```

## Kconfig
```
# Copyright (c) 2025 Analog Devices, Inc.
# Copyright (c) 2025 Antmicro <www.antmicro.com>
#
# SPDX-License-Identifier: Apache-2.0

rsource "../../common/tvm/Kconfig"

source "Kconfig.zephyr"
```

## sample.yaml
```
# Copyright (c) 2025 Analog Devices, Inc.
# Copyright (c) 2025 Antmicro <www.antmicro.com>
#
# SPDX-License-Identifier: Apache-2.0

sample:
  name: tvm_profiler
common:
  tags: profiling
  platform_exclude:
    - mpfs_icicle/polarfire/u54/smp
tests:
  sample.trace.tvm_profiler.plaintext:
    harness: console
    harness_config:
      type: one_line
      regex:
        - "zpl_tvm_enter_event: op_idx=3 tag=tvmgen_default_fused_nn_conv2d_add_nn_relu"
        - "zpl_tvm_exit_event: op_idx=3 tag=tvmgen_default_fused_nn_conv2d_add_nn_relu"
  sample.trace.tvm_profiler.plaintext.robot:
    harness: robot
    harness_config:
      robot_testsuite: tvm_profiler_plaintext.robot
  sample.trace.tvm_profiler.ctf.robot:
    extra_configs:
      - CONFIG_TRACING_BUFFER_SIZE=4096
      - CONFIG_ZPL_TRACE_FORMAT_CTF=y
      - CONFIG_BOOT_BANNER=n
      - CONFIG_PRINTK=n
    harness: robot
    harness_config:
      robot_testsuite: tvm_profiler_ctf.robot
```

## prj.conf
```kconfig
CONFIG_ZPL=y
CONFIG_ZPL_TRACE=y
CONFIG_ZPL_TVM_PROFILER=y

CONFIG_TRACING_BUFFER_SIZE=4096
CONFIG_MAIN_STACK_SIZE=3072

CONFIG_TIMING_FUNCTIONS=y
CONFIG_TEST_RANDOM_GENERATOR=y
CONFIG_ZEPHYR_TVM_MODULE=y
CONFIG_ZEPHYR_DLPACK_MODULE=y

CONFIG_LOG=y
CONFIG_ZPL_LOG_LEVEL_INF=y
```

## src/main.c
```c
/*
 * Copyright (c) 2025 Analog Devices, Inc.
 * Copyright (c) 2025 Antmicro <www.antmicro.com>
 *
 * SPDX-License-Identifier: Apache-2.0
 */

#include <zpl.h>

#include <zephyr/kernel.h>
#include <zephyr/random/random.h>
#include <generated/model_data_graph.h>
#include <generated/model_data_params.h>
#include <tvm_model.h>

#define N_SAMPLES 10
#define INPUT_SHAPE_0 128
#define INPUT_SHAPE_1 3
#define INPUT_MIN_VAL -2040.0f
#define INPUT_MAX_VAL 2040.0f

void rand_input(float model_input[][INPUT_SHAPE_1]);

int main(void)
{
	int status = 0;
	float __attribute((aligned(32))) model_input[INPUT_SHAPE_0][INPUT_SHAPE_1];

	status = model_init();
	if (status) {
		printk("Model init failed %d\n", status);
		return 1;
	}

	status = model_load(model_data_graph, model_data_graph_len, model_data_params, model_data_params_len, NULL, NULL, NULL);
	if (status) {
		printk("Model load failed %d\n", status);
		return 1;
	}

	for (int batch_index = 0; batch_index < N_SAMPLES; ++batch_index) {
		rand_input(model_input);
		status = model_load_input((uint8_t *)model_input, sizeof(float) * INPUT_SHAPE_0 * INPUT_SHAPE_1, NULL, false);
		if (status) {
			printk("Model load input failed %d\n", status);
			break;
		}

		status = model_run(NULL);
		if (status) {
			printk("Model run failed %d\n", status);
			break;
		}
	}

	return 0;
}

void rand_input(float model_input[][INPUT_SHAPE_1])
{
	for (int i = 0; i < INPUT_SHAPE_0; ++i) {
		for (int j = 0; j < INPUT_SHAPE_1; ++j) {
			model_input[i][j] = (
				(INPUT_MAX_VAL - INPUT_MIN_VAL) * (float)sys_rand32_get() / (float)0xFFFFFFFF
			) + INPUT_MIN_VAL;
		}
	}
}
```

## src/magic_wand.c
```c
// tvm target: c -keys=arm_cpu,cpu -device=arm_cpu -march=armv7e-m -mcpu=cortex-m7 -model=stm32f746xx
#define TVM_EXPORTS
#include "tvm/runtime/c_runtime_api.h"
#include <math.h>
#include <stdbool.h>
#ifdef __cplusplus
extern "C"
#endif
    TVM_DLL int32_t
    tvmgen_default_fused_nn_batch_flatten(void *args, int32_t *arg_type_ids, int32_t num_args, void *out_ret_value,
                                          int32_t *out_ret_tcode, void *resource_handle);
#ifdef __cplusplus
extern "C"
#endif
    TVM_DLL int32_t
    tvmgen_default_fused_nn_conv2d_add_nn_relu(void *args, int32_t *arg_type_ids, int32_t num_args, void *out_ret_value,
                                               int32_t *out_ret_tcode, void *resource_handle);
#ifdef __cplusplus
extern "C"
#endif
    TVM_DLL int32_t
    tvmgen_default_fused_nn_conv2d_add_nn_relu_1(void *args, int32_t *arg_type_ids, int32_t num_args,
                                                 void *out_ret_value, int32_t *out_ret_tcode, void *resource_handle);
#ifdef __cplusplus
extern "C"
#endif
    TVM_DLL int32_t
    tvmgen_default_fused_nn_dense_add(void *args, int32_t *arg_type_ids, int32_t num_args, void *out_ret_value,
                                      int32_t *out_ret_tcode, void *resource_handle);
#ifdef __cplusplus
extern "C"
#endif
    TVM_DLL int32_t
    tvmgen_default_fused_nn_dense_add_nn_relu(void *args, int32_t *arg_type_ids, int32_t num_args, void *out_ret_value,
                                              int32_t *out_ret_tcode, void *resource_handle);
#ifdef __cplusplus
extern "C"
#endif
    TVM_DLL int32_t
    tvmgen_default_fused_nn_max_pool2d(void *args, int32_t *arg_type_ids, int32_t num_args, void *out_ret_value,
                                       int32_t *out_ret_tcode, void *resource_handle);
#ifdef __cplusplus
extern "C"
#endif
    TVM_DLL int32_t
    tvmgen_default_fused_nn_max_pool2d_1(void *args, int32_t *arg_type_ids, int32_t num_args, void *out_ret_value,
                                         int32_t *out_ret_tcode, void *resource_handle);
#ifdef __cplusplus
extern "C"
#endif
    TVM_DLL int32_t
    tvmgen_default_fused_nn_softmax(void *args, int32_t *arg_type_ids, int32_t num_args, void *out_ret_value,
                                    int32_t *out_ret_tcode, void *resource_handle);
#ifdef __cplusplus
extern "C"
#endif
    TVM_DLL float
    expf(float);
#ifdef __cplusplus
extern "C"
#endif
    TVM_DLL int32_t
    tvmgen_default_fused_nn_batch_flatten(void *args, int32_t *arg_type_ids, int32_t num_args, void *out_ret_value,
                                          int32_t *out_ret_tcode, void *resource_handle)
{
    void *p0 = (((TVMValue *)args)[0].v_handle);
    void *tensor = (((TVMValue *)args)[1].v_handle);
    void *p0_1 = (((DLTensor *)p0)[0].data);
    void *tvmgen_default_fused_nn_batch_flatten_p0_strides = (((DLTensor *)p0)[0].strides);
    void *tensor_1 = (((DLTensor *)tensor)[0].data);
    void *tvmgen_default_fused_nn_batch_flatten_tensor_strides = (((DLTensor *)tensor)[0].strides);
    if (!(tvmgen_default_fused_nn_batch_flatten_p0_strides == NULL))
    {
    }
    if (!(tvmgen_default_fused_nn_batch_flatten_tensor_strides == NULL))
    {
    }
    for (int32_t ax1_outer = 0; ax1_outer < 56; ++ax1_outer)
    {
        for (int32_t ax1_inner = 0; ax1_inner < 4; ++ax1_inner)
        {
            int32_t cse_var_1 = ((ax1_outer * 4) + ax1_inner);
            ((float *)tensor_1)[cse_var_1] = ((float *)p0_1)[cse_var_1];
        }
    }
    return 0;
}

#ifdef __cplusplus
extern "C"
#endif
    TVM_DLL int32_t
    tvmgen_default_fused_nn_conv2d_add_nn_relu(void *args, int32_t *arg_type_ids, int32_t num_args, void *out_ret_value,
                                               int32_t *out_ret_tcode, void *resource_handle)
{
    void *p0 = (((TVMValue *)args)[0].v_handle);
    void *p1 = (((TVMValue *)args)[1].v_handle);
    void *p2 = (((TVMValue *)args)[2].v_handle);
    void *T_relu = (((TVMValue *)args)[3].v_handle);
    void *p0_1 = (((DLTensor *)p0)[0].data);
    void *tvmgen_default_fused_nn_conv2d_add_nn_relu_p0_strides = (((DLTensor *)p0)[0].strides);
    void *p1_1 = (((DLTensor *)p1)[0].data);
    void *tvmgen_default_fused_nn_conv2d_add_nn_relu_p1_strides = (((DLTensor *)p1)[0].strides);
    void *p2_1 = (((DLTensor *)p2)[0].data);
    void *tvmgen_default_fused_nn_conv2d_add_nn_relu_p2_strides = (((DLTensor *)p2)[0].strides);
    void *T_relu_1 = (((DLTensor *)T_relu)[0].data);
    void *tvmgen_default_fused_nn_conv2d_add_nn_relu_T_relu_strides = (((DLTensor *)T_relu)[0].strides);
    if (!(tvmgen_default_fused_nn_conv2d_add_nn_relu_p0_strides == NULL))
    {
    }
    if (!(tvmgen_default_fused_nn_conv2d_add_nn_relu_p1_strides == NULL))
    {
    }
    if (!(tvmgen_default_fused_nn_conv2d_add_nn_relu_p2_strides == NULL))
    {
    }
    if (!(tvmgen_default_fused_nn_conv2d_add_nn_relu_T_relu_strides == NULL))
    {
    }
    for (int32_t ax0_ax1_outer_fused = 0; ax0_ax1_outer_fused < 128; ++ax0_ax1_outer_fused)
    {
        float PadInput[12];
        float conv[8];
        for (int32_t ax2_outer = 0; ax2_outer < 3; ++ax2_outer)
        {
            for (int32_t i1 = 0; i1 < 4; ++i1)
            {
                for (int32_t i2 = 0; i2 < 3; ++i2)
                {
                    int32_t cse_var_3 = (i1 + ax0_ax1_outer_fused);
                    int32_t cse_var_2 = (i2 + ax2_outer);
                    int32_t cse_var_1 = (i1 * 3);
                    PadInput[(cse_var_1 + i2)] =
                        (((((1 <= cse_var_3) && (cse_var_3 < 129)) && (1 <= cse_var_2)) && (cse_var_2 < 4))
                             ? ((float *)p0_1)[((((cse_var_1 + (ax0_ax1_outer_fused * 3)) + i2) + ax2_outer) - 4)]
                             : 0.000000e+00f);
                }
            }
            for (int32_t oci_init = 0; oci_init < 8; ++oci_init)
            {
                conv[oci_init] = 0.000000e+00f;
            }
            for (int32_t kh = 0; kh < 4; ++kh)
            {
                for (int32_t kw = 0; kw < 3; ++kw)
                {
                    for (int32_t oci = 0; oci < 8; ++oci)
                    {
                        conv[oci] =
                            (conv[oci] + (PadInput[((kh * 3) + kw)] * ((float *)p1_1)[(((kh * 24) + (kw * 8)) + oci)]));
                    }
                }
            }
            for (int32_t ax3_inner = 0; ax3_inner < 8; ++ax3_inner)
            {
                float v_ = conv[ax3_inner] + ((float *)p2_1)[ax3_inner];
                ((float *)T_relu_1)[(((ax0_ax1_outer_fused * 24) + (ax2_outer * 8)) + ax3_inner)] =
                    ((v_) > (0.000000e+00f) ? (v_) : (0.000000e+00f));
            }
        }
    }
    return 0;
}

#ifdef __cplusplus
extern "C"
#endif
    TVM_DLL int32_t
    tvmgen_default_fused_nn_conv2d_add_nn_relu_1(void *args, int32_t *arg_type_ids, int32_t num_args,
                                                 void *out_ret_value, int32_t *out_ret_tcode, void *resource_handle)
{
    void *p0 = (((TVMValue *)args)[0].v_handle);
    void *p1 = (((TVMValue *)args)[1].v_handle);
    void *p2 = (((TVMValue *)args)[2].v_handle);
    void *T_relu = (((TVMValue *)args)[3].v_handle);
    void *p0_1 = (((DLTensor *)p0)[0].data);
    void *tvmgen_default_fused_nn_conv2d_add_nn_relu_1_p0_strides = (((DLTensor *)p0)[0].strides);
    void *p1_1 = (((DLTensor *)p1)[0].data);
    void *tvmgen_default_fused_nn_conv2d_add_nn_relu_1_p1_strides = (((DLTensor *)p1)[0].strides);
    void *p2_1 = (((DLTensor *)p2)[0].data);
    void *tvmgen_default_fused_nn_conv2d_add_nn_relu_1_p2_strides = (((DLTensor *)p2)[0].strides);
    void *T_relu_1 = (((DLTensor *)T_relu)[0].data);
    void *tvmgen_default_fused_nn_conv2d_add_nn_relu_1_T_relu_strides = (((DLTensor *)T_relu)[0].strides);
    if (!(tvmgen_default_fused_nn_conv2d_add_nn_relu_1_p0_strides == NULL))
    {
    }
    if (!(tvmgen_default_fused_nn_conv2d_add_nn_relu_1_p1_strides == NULL))
    {
    }
    if (!(tvmgen_default_fused_nn_conv2d_add_nn_relu_1_p2_strides == NULL))
    {
    }
    if (!(tvmgen_default_fused_nn_conv2d_add_nn_relu_1_T_relu_strides == NULL))
    {
    }
    for (int32_t ax0_ax1_outer_fused = 0; ax0_ax1_outer_fused < 42; ++ax0_ax1_outer_fused)
    {
        float PadInput[32];
        float conv[16];
        for (int32_t i1 = 0; i1 < 4; ++i1)
        {
            for (int32_t i3 = 0; i3 < 8; ++i3)
            {
                int32_t cse_var_2 = (i1 + ax0_ax1_outer_fused);
                int32_t cse_var_1 = (i1 * 8);
                PadInput[(cse_var_1 + i3)] =
                    (((1 <= cse_var_2) && (cse_var_2 < 43))
                         ? ((float *)p0_1)[(((cse_var_1 + (ax0_ax1_outer_fused * 8)) + i3) - 8)]
                         : 0.000000e+00f);
            }
        }
        for (int32_t oco = 0; oco < 2; ++oco)
        {
            for (int32_t oci_init = 0; oci_init < 8; ++oci_init)
            {
                conv[((oco * 8) + oci_init)] = 0.000000e+00f;
            }
            for (int32_t kh = 0; kh < 4; ++kh)
            {
                for (int32_t ic = 0; ic < 8; ++ic)
                {
                    for (int32_t oci = 0; oci < 8; ++oci)
                    {
                        int32_t cse_var_4 = (oco * 8);
                        int32_t cse_var_3 = (cse_var_4 + oci);
                        conv[cse_var_3] =
                            (conv[cse_var_3] + (PadInput[((kh * 8) + ic)] *
                                                ((float *)p1_1)[((((kh * 128) + (ic * 16)) + cse_var_4) + oci)]));
                    }
                }
            }
        }
        for (int32_t ax3_outer = 0; ax3_outer < 2; ++ax3_outer)
        {
            for (int32_t ax3_inner = 0; ax3_inner < 8; ++ax3_inner)
            {
                int32_t cse_var_6 = (ax3_outer * 8);
                int32_t cse_var_5 = (cse_var_6 + ax3_inner);
                float v_ = conv[cse_var_5] + ((float *)p2_1)[cse_var_5];
                ((float *)T_relu_1)[(((ax0_ax1_outer_fused * 16) + cse_var_6) + ax3_inner)] =
                    ((v_) > (0.000000e+00f) ? (v_) : (0.000000e+00f));
            }
        }
    }
    return 0;
}

#ifdef __cplusplus
extern "C"
#endif
    TVM_DLL int32_t
    tvmgen_default_fused_nn_dense_add(void *args, int32_t *arg_type_ids, int32_t num_args, void *out_ret_value,
                                      int32_t *out_ret_tcode, void *resource_handle)
{
    void *p0 = (((TVMValue *)args)[0].v_handle);
    void *p1 = (((TVMValue *)args)[1].v_handle);
    void *p2 = (((TVMValue *)args)[2].v_handle);
    void *T_add = (((TVMValue *)args)[3].v_handle);
    void *p0_1 = (((DLTensor *)p0)[0].data);
    void *tvmgen_default_fused_nn_dense_add_p0_strides = (((DLTensor *)p0)[0].strides);
    void *p1_1 = (((DLTensor *)p1)[0].data);
    void *tvmgen_default_fused_nn_dense_add_p1_strides = (((DLTensor *)p1)[0].strides);
    void *p2_1 = (((DLTensor *)p2)[0].data);
    void *tvmgen_default_fused_nn_dense_add_p2_strides = (((DLTensor *)p2)[0].strides);
    void *T_add_1 = (((DLTensor *)T_add)[0].data);
    void *tvmgen_default_fused_nn_dense_add_T_add_strides = (((DLTensor *)T_add)[0].strides);
    if (!(tvmgen_default_fused_nn_dense_add_p0_strides == NULL))
    {
    }
    if (!(tvmgen_default_fused_nn_dense_add_p1_strides == NULL))
    {
    }
    if (!(tvmgen_default_fused_nn_dense_add_p2_strides == NULL))
    {
    }
    if (!(tvmgen_default_fused_nn_dense_add_T_add_strides == NULL))
    {
    }
    float packed_weight[64];
    float compute_global[4];
    for (int32_t y = 0; y < 16; ++y)
    {
        for (int32_t x = 0; x < 4; ++x)
        {
            packed_weight[((y * 4) + x)] = ((float *)p1_1)[((x * 16) + y)];
        }
    }
    for (int32_t x_c_init = 0; x_c_init < 4; ++x_c_init)
    {
        compute_global[x_c_init] = 0.000000e+00f;
    }
    for (int32_t k_outer = 0; k_outer < 16; ++k_outer)
    {
        for (int32_t x_c = 0; x_c < 4; ++x_c)
        {
            compute_global[x_c] =
                (compute_global[x_c] + (((float *)p0_1)[k_outer] * packed_weight[((k_outer * 4) + x_c)]));
        }
    }
    for (int32_t ax1_inner_inner = 0; ax1_inner_inner < 4; ++ax1_inner_inner)
    {
        ((float *)T_add_1)[ax1_inner_inner] = (compute_global[ax1_inner_inner] + ((float *)p2_1)[ax1_inner_inner]);
    }
    return 0;
}

#ifdef __cplusplus
extern "C"
#endif
    TVM_DLL int32_t
    tvmgen_default_fused_nn_dense_add_nn_relu(void *args, int32_t *arg_type_ids, int32_t num_args, void *out_ret_value,
                                              int32_t *out_ret_tcode, void *resource_handle)
{
    void *p0 = (((TVMValue *)args)[0].v_handle);
    void *p1 = (((TVMValue *)args)[1].v_handle);
    void *p2 = (((TVMValue *)args)[2].v_handle);
    void *T_relu = (((TVMValue *)args)[3].v_handle);
    void *p0_1 = (((DLTensor *)p0)[0].data);
    void *tvmgen_default_fused_nn_dense_add_nn_relu_p0_strides = (((DLTensor *)p0)[0].strides);
    void *p1_1 = (((DLTensor *)p1)[0].data);
    void *tvmgen_default_fused_nn_dense_add_nn_relu_p1_strides = (((DLTensor *)p1)[0].strides);
    void *p2_1 = (((DLTensor *)p2)[0].data);
    void *tvmgen_default_fused_nn_dense_add_nn_relu_p2_strides = (((DLTensor *)p2)[0].strides);
    void *T_relu_1 = (((DLTensor *)T_relu)[0].data);
    void *tvmgen_default_fused_nn_dense_add_nn_relu_T_relu_strides = (((DLTensor *)T_relu)[0].strides);
    if (!(tvmgen_default_fused_nn_dense_add_nn_relu_p0_strides == NULL))
    {
    }
    if (!(tvmgen_default_fused_nn_dense_add_nn_relu_p1_strides == NULL))
    {
    }
    if (!(tvmgen_default_fused_nn_dense_add_nn_relu_p2_strides == NULL))
    {
    }
    if (!(tvmgen_default_fused_nn_dense_add_nn_relu_T_relu_strides == NULL))
    {
    }
    for (int32_t ax1_outer_ax0_outer_fused = 0; ax1_outer_ax0_outer_fused < 2; ++ax1_outer_ax0_outer_fused)
    {
        float compute_global[8];
        for (int32_t x_c_init = 0; x_c_init < 8; ++x_c_init)
        {
            compute_global[x_c_init] = 0.000000e+00f;
        }
        for (int32_t k_outer = 0; k_outer < 224; ++k_outer)
        {
            for (int32_t x_c = 0; x_c < 8; ++x_c)
            {
                compute_global[x_c] =
                    (compute_global[x_c] +
                     (((float *)p0_1)[k_outer] *
                      ((float *)p1_1)[(((ax1_outer_ax0_outer_fused * 1792) + (k_outer * 8)) + x_c)]));
            }
        }
        for (int32_t ax1_inner_inner = 0; ax1_inner_inner < 8; ++ax1_inner_inner)
        {
            int32_t cse_var_2 = ((ax1_outer_ax0_outer_fused * 8) + ax1_inner_inner);
            float v_ = compute_global[ax1_inner_inner] + ((float *)p2_1)[cse_var_2];
            ((float *)T_relu_1)[cse_var_2] = ((v_) > (0.000000e+00f) ? (v_) : (0.000000e+00f));
        }
    }
    return 0;
}

#ifdef __cplusplus
extern "C"
#endif
    TVM_DLL int32_t
    tvmgen_default_fused_nn_max_pool2d(void *args, int32_t *arg_type_ids, int32_t num_args, void *out_ret_value,
                                       int32_t *out_ret_tcode, void *resource_handle)
{
    void *p0 = (((TVMValue *)args)[0].v_handle);
    void *pool_max = (((TVMValue *)args)[1].v_handle);
    void *p0_1 = (((DLTensor *)p0)[0].data);
    void *tvmgen_default_fused_nn_max_pool2d_p0_strides = (((DLTensor *)p0)[0].strides);
    void *pool_max_1 = (((DLTensor *)pool_max)[0].data);
    void *tvmgen_default_fused_nn_max_pool2d_pool_max_strides = (((DLTensor *)pool_max)[0].strides);
    if (!(tvmgen_default_fused_nn_max_pool2d_p0_strides == NULL))
    {
    }
    if (!(tvmgen_default_fused_nn_max_pool2d_pool_max_strides == NULL))
    {
    }
    for (int32_t ax1 = 0; ax1 < 42; ++ax1)
    {
        for (int32_t ax3 = 0; ax3 < 8; ++ax3)
        {
            ((float *)pool_max_1)[((ax1 * 8) + ax3)] = -3.402823e+38f;
            for (int32_t rv0 = 0; rv0 < 3; ++rv0)
            {
                for (int32_t rv1 = 0; rv1 < 3; ++rv1)
                {
                    int32_t cse_var_1 = ((ax1 * 8) + ax3);
                    float v_ = ((float *)pool_max_1)[cse_var_1];
                    float v__1 = ((float *)p0_1)[((((ax1 * 72) + (rv0 * 24)) + (rv1 * 8)) + ax3)];
                    ((float *)pool_max_1)[cse_var_1] = ((v_) > (v__1) ? (v_) : (v__1));
                }
            }
        }
    }
    return 0;
}

#ifdef __cplusplus
extern "C"
#endif
    TVM_DLL int32_t
    tvmgen_default_fused_nn_max_pool2d_1(void *args, int32_t *arg_type_ids, int32_t num_args, void *out_ret_value,
                                         int32_t *out_ret_tcode, void *resource_handle)
{
    void *p0 = (((TVMValue *)args)[0].v_handle);
    void *pool_max = (((TVMValue *)args)[1].v_handle);
    void *p0_1 = (((DLTensor *)p0)[0].data);
    void *tvmgen_default_fused_nn_max_pool2d_1_p0_strides = (((DLTensor *)p0)[0].strides);
    void *pool_max_1 = (((DLTensor *)pool_max)[0].data);
    void *tvmgen_default_fused_nn_max_pool2d_1_pool_max_strides = (((DLTensor *)pool_max)[0].strides);
    if (!(tvmgen_default_fused_nn_max_pool2d_1_p0_strides == NULL))
    {
    }
    if (!(tvmgen_default_fused_nn_max_pool2d_1_pool_max_strides == NULL))
    {
    }
    for (int32_t ax1 = 0; ax1 < 14; ++ax1)
    {
        for (int32_t ax3 = 0; ax3 < 16; ++ax3)
        {
            ((float *)pool_max_1)[((ax1 * 16) + ax3)] = -3.402823e+38f;
            for (int32_t rv0 = 0; rv0 < 3; ++rv0)
            {
                int32_t cse_var_1 = ((ax1 * 16) + ax3);
                float v_ = ((float *)pool_max_1)[cse_var_1];
                float v__1 = ((float *)p0_1)[(((ax1 * 48) + (rv0 * 16)) + ax3)];
                ((float *)pool_max_1)[cse_var_1] = ((v_) > (v__1) ? (v_) : (v__1));
            }
        }
    }
    return 0;
}

#ifdef __cplusplus
extern "C"
#endif
    TVM_DLL int32_t
    tvmgen_default_fused_nn_softmax(void *args, int32_t *arg_type_ids, int32_t num_args, void *out_ret_value,
                                    int32_t *out_ret_tcode, void *resource_handle)
{
    void *p0 = (((TVMValue *)args)[0].v_handle);
    void *T_softmax_norm = (((TVMValue *)args)[1].v_handle);
    void *p0_1 = (((DLTensor *)p0)[0].data);
    void *tvmgen_default_fused_nn_softmax_p0_strides = (((DLTensor *)p0)[0].strides);
    void *T_softmax_norm_1 = (((DLTensor *)T_softmax_norm)[0].data);
    void *tvmgen_default_fused_nn_softmax_T_softmax_norm_strides = (((DLTensor *)T_softmax_norm)[0].strides);
    if (!(tvmgen_default_fused_nn_softmax_p0_strides == NULL))
    {
    }
    if (!(tvmgen_default_fused_nn_softmax_T_softmax_norm_strides == NULL))
    {
    }
    float T_softmax_maxelem[1];
    float T_softmax_exp[4];
    float T_softmax_expsum[1];
    T_softmax_maxelem[0] = -3.402823e+38f;
    for (int32_t k = 0; k < 4; ++k)
    {
        float v_ = T_softmax_maxelem[0];
        float v__1 = ((float *)p0_1)[k];
        T_softmax_maxelem[0] = ((v_) > (v__1) ? (v_) : (v__1));
    }
    for (int32_t i1 = 0; i1 < 4; ++i1)
    {
        T_softmax_exp[i1] = expf((((float *)p0_1)[i1] - T_softmax_maxelem[0]));
    }
    T_softmax_expsum[0] = 0.000000e+00f;
    for (int32_t k_1 = 0; k_1 < 4; ++k_1)
    {
        T_softmax_expsum[0] = (T_softmax_expsum[0] + T_softmax_exp[k_1]);
    }
    for (int32_t i1_1 = 0; i1_1 < 4; ++i1_1)
    {
        ((float *)T_softmax_norm_1)[i1_1] = (T_softmax_exp[i1_1] / T_softmax_expsum[0]);
    }
    return 0;
}
```

## src/magic_wand.h
```c
#ifndef SAMPLES_TRACE_TVM_PROFILER_SRC_MAGIC_WAND_H_
#define SAMPLES_TRACE_TVM_PROFILER_SRC_MAGIC_WAND_H_

#include <tvm/runtime/crt/module.h>
#include <tvm/runtime/crt/packed_func.h>

#define TVMGEN_FUNCTIONS(FUNC)                         \
    FUNC(tvmgen_default_fused_nn_batch_flatten)        \
    FUNC(tvmgen_default_fused_nn_conv2d_add_nn_relu)   \
    FUNC(tvmgen_default_fused_nn_conv2d_add_nn_relu_1) \
    FUNC(tvmgen_default_fused_nn_dense_add)            \
    FUNC(tvmgen_default_fused_nn_dense_add_nn_relu)    \
    FUNC(tvmgen_default_fused_nn_max_pool2d)           \
    FUNC(tvmgen_default_fused_nn_max_pool2d_1)         \
    FUNC(tvmgen_default_fused_nn_softmax)

#define TVMGEN_FUNCTIONS_COUNT "\x08"

#define TVMGEN_DECLARE(func_name)                                                                      \
    extern int32_t func_name(void *args, int32_t *arg_type_ids, int32_t num_args, void *out_ret_value, \
                             int32_t *out_ret_tcode, void *resource_handle);

#define TVMGEN_FUNC_ARRAY(func_name) (TVMBackendPackedCFunc) func_name,

#define TVMGEN_FUNC_REGISTRY(func_name) "\0" #func_name

TVMGEN_FUNCTIONS(TVMGEN_DECLARE);

const TVMBackendPackedCFunc tvm_func_array[] = {TVMGEN_FUNCTIONS(TVMGEN_FUNC_ARRAY)};

const TVMFuncRegistry tvm_func_reg = {.names = TVMGEN_FUNCTIONS_COUNT TVMGEN_FUNCTIONS(TVMGEN_FUNC_REGISTRY) "\0",
                                      .funcs = tvm_func_array};

const TVMModule g_tvm_module = {&tvm_func_reg};

const TVMModule *TVMSystemLibEntryPoint(void) { return &g_tvm_module; }

#endif // SAMPLES_TRACE_TVM_PROFILER_SRC_MAGIC_WAND_H_
```

## src/model.c
```c
#include <tvm/runtime/c_backend_api.h>
#include <tvm/runtime/crt/crt.h>
#include <tvm/runtime/crt/graph_executor.h>
#include <tvm/runtime/crt/internal/graph_executor/graph_executor.h>
#include <dlpack/dlpack.h>
#include <zephyr/kernel.h>
#include <zpl/tvm_profiler.h>
#include "model.h"
#include "magic_wand.h"

extern TVMProfiler tvm_profiler;

static uint8_t __attribute__((aligned(32))) gp_tvmInputBuffer[TVM_INPUT_BUFFER_SIZE * 1024];

static const DLDevice g_device = {kDLCPU, 1};
static TVMGraphExecutor *gp_tvm_graph_executor = NULL;
static TVMModuleHandle g_tvm_module_handle;

int model_init(void)
{
    return TVMInitializeRuntime();
}
int model_load(const uint8_t *model_graph, uint32_t model_graph_size, const uint8_t *model_params, uint32_t model_params_size)
{
    int status = 0;

    do {
        const TVMModule *tvm_module = TVMSystemLibEntryPoint();
        if (NULL == tvm_module)
        {
            status = 1;
            break;
        }

        status = TVMModCreateFromCModule(tvm_module, &g_tvm_module_handle);
        if (status){
            break;
        }

        status = TVMGraphExecutor_Create(model_graph, g_tvm_module_handle, &g_device,
                                         &gp_tvm_graph_executor);
        if (status){
            break;
        }

        status = TVMGraphExecutor_LoadParams(gp_tvm_graph_executor, model_params,
                                             model_params_size);
        if (status){
            break;
        }
    } while(0);

    return status;
}
int model_load_input(const uint8_t *input, uint32_t input_size)
{
    DLTensor tensor_in;

    tensor_in.device = g_device;
    tensor_in.ndim = 4;
    tensor_in.dtype.code = kDLFloat;
    tensor_in.dtype.bits = 32;
    tensor_in.dtype.lanes = 0;
    uint64_t shape[4] = {1, 128, 3, 1};
    tensor_in.shape = shape;
    tensor_in.strides = NULL;
    tensor_in.byte_offset = 0;

    tensor_in.data = (void *)gp_tvmInputBuffer;

    // TVM does not allow setting input by index, so we need to retrieve its name
    uint32_t input_node_id = gp_tvm_graph_executor->input_nodes[0];
    char *input_name = gp_tvm_graph_executor->nodes[input_node_id].name;

    TVMGraphExecutor_SetInput(gp_tvm_graph_executor, input_name, &tensor_in);
    return 0;
}
int model_run(void)
{
    TVMGraphExecutor_Run(gp_tvm_graph_executor, &tvm_profiler);

    zpl_tvm_profiler_dump_events();
    return 0;
}
```

## src/model.h
```c
#ifndef SAMPLES_TRACE_TVM_PROFILER_SRC_MODEL_H_
#define SAMPLES_TRACE_TVM_PROFILER_SRC_MODEL_H_

#include <stdint.h>

#define TVM_HEAP_SIZE 45
#define TVM_INPUT_BUFFER_SIZE 2

int model_init(void);
int model_load(const uint8_t *model_graph, uint32_t model_graph_size, const uint8_t *model_params, uint32_t model_params_size);
int model_load_input(const uint8_t *input, uint32_t input_size);
int model_run(void);

#endif /* SAMPLES_TRACE_TVM_PROFILER_SRC_MODEL_H_ */
```

## src/platform.c
```c
#include <dlpack/dlpack.h>
#include <stdint.h>
#include <stdio.h>
#include <tvm/runtime/crt/error_codes.h>
#include <zephyr/kernel.h>
#include <zephyr/random/random.h>
#include <zephyr/sys/reboot.h>
#include <zephyr/timing/timing.h>

#include "model.h"

K_HEAP_DEFINE(tvm_heap, 1024 * TVM_HEAP_SIZE);

volatile timing_t g_microtvm_start_time, g_microtvm_end_time;
int g_microtvm_timer_running = 0;

void k_sys_fatal_error_handler(unsigned int reason, const struct arch_esf *esf)
{
    for (;;)
        ;
}

void TVMLogf(const char *msg, ...)
{
    va_list argptr;
    va_start(argptr, msg);
    vfprintf(stderr, msg, argptr);
    va_end(argptr);
}

void TVMPlatformAbort(tvm_crt_error_t error)
{
#ifdef CONFIG_REBOOT
    sys_reboot(SYS_REBOOT_COLD);
#endif // CONFIG_REBOOT
    for (;;)
        ;
}

size_t TVMPlatformFormatMessage(char *out_buf, size_t out_buf_size_bytes, const char *fmt, va_list args)
{
    return vsnprintk(out_buf, out_buf_size_bytes, fmt, args);
}

tvm_crt_error_t TVMPlatformMemoryAllocate(size_t num_bytes, DLDevice dev, void **out_ptr)
{
    if (0 == num_bytes)
    {
        *out_ptr = NULL;
        return kTvmErrorNoError;
    }
    *out_ptr = k_heap_alloc(&tvm_heap, num_bytes, K_NO_WAIT);
    return (*out_ptr == NULL) ? kTvmErrorPlatformNoMemory : kTvmErrorNoError;
}

tvm_crt_error_t TVMPlatformMemoryFree(void *ptr, DLDevice dev)
{
    if (NULL == ptr)
    {
        return kTvmErrorNoError;
    }
    k_heap_free(&tvm_heap, ptr);
    return kTvmErrorNoError;
}

tvm_crt_error_t TVMPlatformTimerStart()
{
    if (g_microtvm_timer_running)
    {
        return kTvmErrorPlatformTimerBadState;
    }

    g_microtvm_start_time = timing_counter_get();
    g_microtvm_timer_running = 1;
    return kTvmErrorNoError;
}

tvm_crt_error_t TVMPlatformTimerStop(double *elapsed_time_seconds)
{
    if (!g_microtvm_timer_running)
    {
        return kTvmErrorSystemErrorMask | 2;
    }

    g_microtvm_end_time = timing_counter_get();
    uint64_t cycles = timing_cycles_get(&g_microtvm_start_time, &g_microtvm_end_time);
    uint64_t ns_spent = timing_cycles_to_ns(cycles);
    *elapsed_time_seconds = ns_spent / (double)1e9;
    g_microtvm_timer_running = 0;
    return kTvmErrorNoError;
}

tvm_crt_error_t TVMPlatformGenerateRandom(uint8_t *buffer, size_t num_bytes)
{
    uint32_t random;

    // Fill parts of `buffer` which are as large as `random`.
    size_t num_full_blocks = num_bytes / sizeof(random);
    for (int i = 0; i < num_full_blocks; ++i)
    {
        random = sys_rand32_get();
        memcpy(&buffer[i * sizeof(random)], &random, sizeof(random));
    }

    // Fill any leftover tail which is smaller than `random`.
    size_t num_tail_bytes = num_bytes % sizeof(random);
    if (num_tail_bytes > 0)
    {
        random = sys_rand32_get();
        memcpy(&buffer[num_bytes - num_tail_bytes], &random, num_tail_bytes);
    }
    return kTvmErrorNoError;
}

tvm_crt_error_t TVMPlatformInitialize()
{
    timing_init();
    timing_start();

    return kTvmErrorNoError;
}
```
