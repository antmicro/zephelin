## CMakeLists.txt
```
# Copyright (c) 2026 Analog Devices, Inc.
# Copyright (c) 2026 Antmicro <www.antmicro.com>
#
# SPDX-License-Identifier: Apache-2.0

cmake_minimum_required(VERSION 3.20.0)

include(${CMAKE_CURRENT_SOURCE_DIR}/../../common/boards.cmake)

find_package(Zephyr REQUIRED HINTS $ENV{ZEPHYR_BASE})
project(app)
target_sources(app PRIVATE src/main.cpp)

add_subdirectory(${CMAKE_CURRENT_SOURCE_DIR}/../../common/tflm ${CMAKE_CURRENT_BINARY_DIR}/tflm)
target_link_libraries(app PRIVATE tflm_model)
```

## Kconfig
```
# Copyright (c) 2026 Analog Devices, Inc.
# Copyright (c) 2026 Antmicro <www.antmicro.com>
#
# SPDX-License-Identifier: Apache-2.0

rsource "../../common/tflm/Kconfig"

source "Kconfig.zephyr"
```

## prj.conf
```kconfig
CONFIG_ZPL=y
CONFIG_ZPL_TRACE=y
CONFIG_ZPL_TFLM_PROFILER=y
CONFIG_ZPL_SCOPE_MARKING=y
CONFIG_ZPL_SAMPLE_TFLM_NUM_ITERS=1000
CONFIG_ZPL_TFLM_PROFILER_DELAYED_EMISSION=n
CONFIG_TRACING_BUFFER_SIZE=4096
CONFIG_TRACING_SYNC=y
CONFIG_MAIN_STACK_SIZE=3072

CONFIG_TEST_RANDOM_GENERATOR=y
CONFIG_TENSORFLOW_LITE_MICRO=y
CONFIG_ZPL_SAMPLE_TFLM_BUFFER_SIZE=20
CONFIG_CPP=y
CONFIG_ZPL_TRACE_FORMAT_CTF=y
CONFIG_STD_CPP17=y

CONFIG_BOOT_BANNER=n
CONFIG_PRINTK=n
CONFIG_LOG=n
```

## src/main.cpp
```c
/*
 * Copyright (c) 2026 Analog Devices, Inc.
 * Copyright (c) 2026 Antmicro <www.antmicro.com>
 *
 * SPDX-License-Identifier: Apache-2.0
 */

extern "C" {
#include <zpl.h>
#include <zpl/scope_event.h>

#include <zephyr/kernel.h>
#include <zephyr/random/random.h>
#include <generated/model0_data.h>
}
#include <tflm_model.h>

#define INPUT_SHAPE_0 128
#define INPUT_SHAPE_1 3

using namespace tflm;

static void interrupt_timer_handler(struct k_timer *timer)
{
	zpl_emit_scope_event((char *)"interrupt", 0);
	k_busy_wait(200);
	zpl_emit_scope_event((char *)"interrupt", 1);
}

K_TIMER_DEFINE(interrupt_timer, interrupt_timer_handler, NULL);

int main(void)
{
	float __attribute((aligned(32))) model_input[INPUT_SHAPE_0][INPUT_SHAPE_1] = {};

	model_init();
	if (model_load(model0_data)) {
		return 1;
	}

	k_timer_start(&interrupt_timer, K_MSEC(2), K_MSEC(2));

	for (int i = 0; i < CONFIG_ZPL_SAMPLE_TFLM_NUM_ITERS; ++i) {
		if (model_load_input((uint8_t *)model_input, sizeof(model_input))) {
			break;
		}
		if (model_run()) {
			break;
		}
	}

	k_timer_stop(&interrupt_timer);

	return 0;
}
```
