## CMakeLists.txt
```
# Copyright (c) 2025 Analog Devices, Inc.
# Copyright (c) 2025 Antmicro <www.antmicro.com>
#
# SPDX-License-Identifier: Apache-2.0

cmake_minimum_required(VERSION 3.20.0)

include(${CMAKE_CURRENT_SOURCE_DIR}/../../common/instrumentation/boards.cmake)

find_package(Zephyr REQUIRED HINTS $ENV{ZEPHYR_BASE})
project(app)
target_sources(app PRIVATE src/main.c)

add_subdirectory(${CMAKE_CURRENT_SOURCE_DIR}/../../common/tvm ${CMAKE_CURRENT_BINARY_DIR}/tvm)
target_link_libraries(app PRIVATE tvm_model)
```

## sample.yaml
```
# Copyright (c) 2025 Analog Devices, Inc.
# Copyright (c) 2025 Antmicro <www.antmicro.com>
#
# SPDX-License-Identifier: Apache-2.0

sample:
  name: tvm_instrumentation
common:
  tags: profiling
  platform_exclude:
    - mpfs_icicle/polarfire/u54/smp
tests:
  sample.profiling.tvm_instrumentation.robot:
    harness: robot
    harness_config:
      robot_testsuite: instrumentation.robot
  sample.profiling.tvm_instrumentation_zpl.robot:
    min_ram: 100
    extra_args: EXTRA_CONF_FILE=zpl.conf
    harness: robot
    harness_config:
      robot_testsuite: instrumentation.robot
```

## prj.conf
```kconfig
CONFIG_INSTRUMENTATION=y
CONFIG_INSTRUMENTATION_MODE_CALLGRAPH_BUFFER_OVERWRITE=n

CONFIG_MAIN_STACK_SIZE=3072

CONFIG_TIMING_FUNCTIONS=y
CONFIG_TEST_RANDOM_GENERATOR=y
CONFIG_ZEPHYR_TVM_MODULE=y
CONFIG_ZEPHYR_DLPACK_MODULE=y

CONFIG_ZPL_SAMPLE_TVM_HEAP_SIZE=30
CONFIG_ZPL_SAMPLE_TVM_QUANTIZED_MODEL=y

CONFIG_TRACING=y
```

## zpl.conf
```kconfig
CONFIG_ZPL_INSTRUMENTATION=y
CONFIG_ZPL_TRACE_BACKEND_DEBUGGER=y

CONFIG_INSTRUMENTATION_TRIGGER_FUNCTION="model_run"
CONFIG_INSTRUMENTATION_STOPPER_FUNCTION="model_run"

CONFIG_SYS_HEAP_ARRAY_SIZE=4
CONFIG_RAM_TRACING_BUFFER_SIZE=16384

CONFIG_ZPL=y
CONFIG_ZPL_TRACE=y
CONFIG_TRACING_SYNC=y

CONFIG_ZPL_TVM_PROFILER=y
CONFIG_ZPL_TVM_PROFILER_MAX_EVENTS=6
CONFIG_ZPL_TRACE_CTF_MAX_LONG_STR_LEN=82

CONFIG_ZPL_MEMORY_PROFILING=y
CONFIG_ZPL_MEMORY_PROFILING_INTERVAL=10
CONFIG_ZPL_MEMORY_PROFILING_THREAD_PRIORITY=-1

CONFIG_CPU_LOAD=y
CONFIG_ZPL_CPU_LOAD_TRACE=y
CONFIG_ZPL_CPU_LOAD_PROFILING=y
CONFIG_ZPL_CPU_LOAD_PROFILING_INTERVAL=10
CONFIG_ZPL_CPU_LOAD_PROFILING_THREAD_PRIORITY=-1

CONFIG_ZPL_SCOPE_MARKING=y
```

## boards/stm32f429i_disc1.conf
```kconfig
CONFIG_INSTRUMENTATION_MODE_CALLGRAPH_TRACE_BUFFER_SIZE=42000
```

## boards/stm32f429i_disc1.overlay
```dts
/ {
	chosen {
		zephyr,tracing-uart = &usart2;
	};
};

&usart2 {
	status = "okay";
	pinctrl-0 = <&usart2_tx_pd5 &usart2_rx_pd6>;
	pinctrl-names = "default";
	current-speed = <115200>;
};
```

## src/main.c
```c
/*
 * Copyright (c) 2025 Analog Devices, Inc.
 * Copyright (c) 2025 Antmicro <www.antmicro.com>
 *
 * SPDX-License-Identifier: Apache-2.0
 */

#include "tvm/runtime/c_runtime_api.h"
#include "tvm/runtime/crt/graph_executor.h"
#include "tvm/runtime/crt/internal/graph_executor/graph_executor.h"
#include "zephyr/irq.h"
#include <zpl.h>

#include <zephyr/kernel.h>
#include <zephyr/random/random.h>
#include <generated/model_data_int8_graph.h>
#include <generated/model_data_int8_params.h>
#include <tvm_model.h>
#include <sine.h>

#define N_SAMPLES     10
#define INPUT_MIN_VAL 0.0f
#define INPUT_MAX_VAL (2.0f * 3.14159265359f)

#define INPUT_SCALE 0.024573976173996925f
#define INPUT_ZERO  -128

ZPL_CODE_SCOPE_DEFINE(prepare_model, true);

void rand_input(float *model_input);

int main(void)
{
	int status = 0;
	float __attribute((aligned(32))) model_input;
	TVMGraphExecutor *executor_quantized = malloc(sizeof(TVMGraphExecutor));
	TVMModuleHandle handle_quantized = NULL;

	ZPL_MARK_CODE_SCOPE(prepare_model) {
		status = model_init();
		if (status) {
			printk("Model init failed %d\n", status);
			return 1;
		}

		status = model_load(model_data_int8_graph, model_data_int8_graph_len, model_data_int8_params, model_data_int8_params_len, &executor_quantized, &handle_quantized, TVMQuantizedLibEntryPoint());
		if (status) {
			printk("Model load failed %d\n", status);
			return 1;
		}
	}

	unsigned int lock_key;
	for (int batch_index = 0; batch_index < N_SAMPLES; ++batch_index) {
		rand_input(&model_input);
		status = model_load_input((uint8_t *)&model_input, sizeof(int8_t), executor_quantized, true);
		if (status) {
			printk("Model load input failed %d\n", status);
			break;
		}

		lock_key = irq_lock();
		status = model_run(executor_quantized);
		irq_unlock(lock_key);
		if (status) {
			printk("Model run failed %d\n", status);
			break;
		}
	}

	free(executor_quantized);
	return 0;
}

void rand_input(float *model_input)
{
	*model_input =
		((INPUT_MAX_VAL - INPUT_MIN_VAL) * (float)sys_rand32_get() / (float)0xFFFFFFFF) +
		INPUT_MIN_VAL;
}
```
