## CMakeLists.txt
```
# Copyright (c) 2025 Analog Devices, Inc.
# Copyright (c) 2025 Antmicro <www.antmicro.com>
#
# SPDX-License-Identifier: Apache-2.0

cmake_minimum_required(VERSION 3.20.0)

include(${CMAKE_CURRENT_SOURCE_DIR}/../../common/boards.cmake)

find_package(Zephyr REQUIRED HINTS $ENV{ZEPHYR_BASE})
project(app)
target_sources(app PRIVATE src/main.cpp)

add_subdirectory(${CMAKE_CURRENT_SOURCE_DIR}/../../common/tflm ${CMAKE_CURRENT_BINARY_DIR}/tflm)
target_link_libraries(app PRIVATE tflm_model)
```

## Kconfig
```
# Copyright (c) 2025 Analog Devices, Inc.
# Copyright (c) 2025 Antmicro <www.antmicro.com>
#
# SPDX-License-Identifier: Apache-2.0

rsource "../../common/tflm/Kconfig"

source "Kconfig.zephyr"
```

## sample.yaml
```
# Copyright (c) 2025 Analog Devices, Inc.
# Copyright (c) 2025 Antmicro <www.antmicro.com>
#
# SPDX-License-Identifier: Apache-2.0

sample:
  name: tflm_multi_model
common:
  tags: profiling
  platform_exclude:
    - mpfs_icicle/polarfire/u54/smp
tests:
  sample.trace.tflm_multi_model.plaintext:
    harness: console
    harness_config:
      type: one_line
      regex:
        - "zpl_inference_enter: model_id"
        - "zpl_tflm_enter_event: subgraph_idx=0 op_idx=0 tag=CONV_2D"
        - "zpl_tflm_exit_event: subgraph_idx=0 op_idx=0 tag=CONV_2D"
        - "zpl_inference_exit: model_id"
        - "zpl_inference_enter: model_id"
        - "zpl_tflm_enter_event: subgraph_idx=0 op_idx=0 tag=FULLY_CONNECTED"
        - "zpl_tflm_exit_event: subgraph_idx=0 op_idx=0 tag=FULLY_CONNECTED"
        - "zpl_inference_exit: model_id"
  sample.trace.tflm_multi_model.plaintext.robot:
    harness: robot
    harness_config:
      robot_testsuite: tflm_multi_plaintext.robot
  sample.trace.tflm_multi_model.ctf.robot:
    extra_configs:
      - CONFIG_ZPL_TRACE_FORMAT_CTF=y
      - CONFIG_BOOT_BANNER=n
      - CONFIG_PRINTK=n
      - CONFIG_LOG=n
    harness: robot
    harness_config:
      robot_testsuite: tflm_multi_ctf.robot
```

## prj.conf
```kconfig
CONFIG_ZPL=y
CONFIG_ZPL_TRACE=y
CONFIG_ZPL_TFLM_PROFILER=y

CONFIG_TRACING_BUFFER_SIZE=4096
CONFIG_TRACING_SYNC=y
CONFIG_MAIN_STACK_SIZE=4096

CONFIG_TEST_RANDOM_GENERATOR=y
CONFIG_TENSORFLOW_LITE_MICRO=y
CONFIG_ZPL_SAMPLE_TFLM_MODEL="magic-wand;sine"
CONFIG_CPP=y
CONFIG_STD_CPP17=y

CONFIG_LOG=y
CONFIG_ZPL_LOG_LEVEL_INF=y

CONFIG_CPU_LOAD=y

CONFIG_ZPL_CPU_LOAD_PROFILING_INTERVAL=100
CONFIG_ZPL_CPU_LOAD_PROFILING=y
CONFIG_ZPL_CPU_LOAD_TRACE=y
CONFIG_ZPL_CPU_LOAD_PROFILING_THREAD_PRIORITY=-1

CONFIG_SYS_HEAP_ARRAY_SIZE=4
CONFIG_ZPL_MEMORY_PROFILING_INTERVAL=200
CONFIG_ZPL_MEMORY_PROFILING=y
CONFIG_ZPL_MEMORY_PROFILING_THREAD_PRIORITY=-1
```

## src/main.cpp
```c
/*
 * Copyright (c) 2025 Analog Devices, Inc.
 * Copyright (c) 2025 Antmicro <www.antmicro.com>
 *
 * SPDX-License-Identifier: Apache-2.0
 */

extern "C" {
#include <zpl.h>

#include <zephyr/kernel.h>
#include <zephyr/random/random.h>
#include <generated/model0_data.h>
#include <generated/model1_data.h>
}

#include <tflm_model.h>

#define INPUT0_SHAPE_0 128
#define INPUT0_SHAPE_1 3
#define INPUT0_MIN_VAL -2040.0f
#define INPUT0_MAX_VAL 2040.0f

#define INPUT1_MIN_VAL 0.0f
#define INPUT1_MAX_VAL (2.0f * 3.14159265359f)
#define INPUT1_SCALE 0.024573976173996925f
#define INPUT1_ZERO  -128

using namespace tflm;

void rand_input0(float model_input[][INPUT0_SHAPE_1]);
void rand_input1(float *model_input);

int main(void)
{
	float __attribute((aligned(32))) model0_input[INPUT0_SHAPE_0][INPUT0_SHAPE_1];
	float model1_input;
	uint8_t model1_input_q;
	tflite::MicroInterpreter* interpreters[] = {nullptr, nullptr};
	int status = 0;

	#ifdef CONFIG_ZPL_TRACE_BACKEND_USB
	k_sleep(K_MSEC(500));
	#endif

	model_init();

	status = model_load(model0_data, interpreters[0], 15500);
	if (status) {
		printk("Model 0 load failed %d\n", status);
		return 1;
	}
	status = model_load(model1_data, interpreters[1]);
	if (status) {
		printk("Model 1 load failed %d\n", status);
		return 1;
	}

	for (short i = 0; i < CONFIG_ZPL_SAMPLE_TFLM_NUM_ITERS; ++i) {

		rand_input0(model0_input);
		status = model_load_input(interpreters[0], (uint8_t *)model0_input,
				sizeof(float) * INPUT0_SHAPE_0 * INPUT0_SHAPE_1);
		if (status) {
			printk("Model 0 load input failed %d\n", status);
			break;
		}

		status = model_run(interpreters[0]);
		if (status) {
			printk("Model 0 run failed %d\n", status);
			break;
		}

		rand_input1(&model1_input);
		model1_input_q = (model1_input / INPUT1_SCALE) + INPUT1_ZERO;

		status = model_load_input(interpreters[1], (uint8_t *)&model1_input_q,
				sizeof(uint8_t));
		if (status) {
			printk("Model 1 load input failed %d\n", status);
			break;
		}

		status = model_run(interpreters[1]);
		if (status) {
			printk("Model 1 run failed %d\n", status);
			break;
		}
	}

	return 0;
}

void rand_input0(float model_input[][INPUT0_SHAPE_1])
{
	for (int i = 0; i < INPUT0_SHAPE_0; ++i) {
		for (int j = 0; j < INPUT0_SHAPE_1; ++j) {
			model_input[i][j] = (
					(INPUT0_MAX_VAL - INPUT0_MIN_VAL) *
					(float)sys_rand32_get() / (float)0xFFFFFFFF)
				+ INPUT0_MIN_VAL;
		}
	}
}

void rand_input1(float *model_input)
{
	*model_input =
		((INPUT1_MAX_VAL - INPUT1_MIN_VAL) * (float)sys_rand32_get() / (float)0xFFFFFFFF) +
		INPUT1_MIN_VAL;
}
```
