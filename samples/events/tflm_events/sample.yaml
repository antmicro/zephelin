## samples/events/tflm_events/sample.yaml
```yaml
# Copyright (c) 2025 Analog Devices, Inc.
# Copyright (c) 2025 Antmicro <www.antmicro.com>
#
# SPDX-License-Identifier: Apache-2.0

sample:
  name: tflm_events
common:
  tags: events
tests:
  sample.trace.tflm_events.plaintext:
    harness: console
    harness_config:
      type: one_line
      regex:
        - "zpl_tflm_enter_event"
  sample.trace.tflm_events.plaintext.robot:
    harness: robot
    harness_config:
      robot_testsuite: tflm_events_plaintext.robot
  sample.trace.tflm_events.ctf.robot:
    extra_configs:
      - CONFIG_TRACING_BUFFER_SIZE=4096
      - CONFIG_ZPL_TRACE_FORMAT_CTF=y
      - CONFIG_BOOT_BANNER=n
      - CONFIG_PRINTK=n
    harness: robot
    harness_config:
      robot_testsuite: tflm_events_ctf.robot
```

## samples/profiling/cpu_load/sample.yaml
```yaml
# Copyright (c) 2025 Analog Devices, Inc.
# Copyright (c) 2025 Antmicro <www.antmicro.com>
#
# SPDX-License-Identifier: Apache-2.0

sample:
  name: cpu_load
common:
  tags: profiling
tests:
  sample.trace.cpu_load.plaintext:
    harness: console
    harness_config:
      type: one_line
      regex:
        - "zpl_cpu_load_event: cpu_load=[0-9]+\\.[0-9]+"
  sample.trace.cpu_load.plaintext.robot:
    harness: robot
    harness_config:
      robot_testsuite: cpu_load_plaintext.robot
  sample.trace.cpu_load.ctf.robot:
    extra_configs:
      - CONFIG_TRACING_BUFFER_SIZE=4096
      - CONFIG_ZPL_TRACE_FORMAT_CTF=y
      - CONFIG_BOOT_BANNER=n
      - CONFIG_PRINTK=n
    harness: robot
    harness_config:
      robot_testsuite: cpu_load_ctf.robot
```

## samples/profiling/die_temp/sample.yaml
```yaml
# Copyright (c) 2025 Analog Devices, Inc.
# Copyright (c) 2025 Antmicro <www.antmicro.com>
#
# SPDX-License-Identifier: Apache-2.0

sample:
  name: die_temp
common:
  tags: profiling
  platform_allow:
    - stm32f429i_disc1/stm32f429xx
tests:
  sample.trace.die_temp.plaintext:
    harness: console
    harness_config:
      type: one_line
      regex:
        - "zpl_die_temp_event: die_temp\\[0\\]=[0-9]+\\.[0-9]+"
  sample.trace.die_temp.plaintext.robot:
    harness: robot
    harness_config:
      robot_testsuite: die_temp_plaintext.robot
  sample.trace.die_temp.ctf.robot:
    extra_configs:
      - CONFIG_ZPL_TRACE_FORMAT_CTF=y
      - CONFIG_BOOT_BANNER=n
      - CONFIG_PRINTK=n
    harness: robot
    harness_config:
      robot_testsuite: die_temp_ctf.robot
```

## samples/trace/cpu_load/sample.yaml
```yaml
# Copyright (c) 2025 Analog Devices, Inc.
# Copyright (c) 2025 Antmicro <www.antmicro.com>
#
# SPDX-License-Identifier: Apache-2.0

sample:
  name: simple
common:
  tags: profiling
  harness: console
  harness_config:
    type: one_line
    regex:
      - "zpl_cpu_load_event: cpu_load=[0-9]+\\.[0-9]+"
tests:
  sample.trace.cpu_load.plaintext:
    tags: profiling
  sample.trace.cpu_load.plaintext.robot:
    tags: profiling
    harness: robot
    harness_config:
      robot_testsuite: cpu_load_plaintext.robot
  sample.trace.cpu_load.ctf.robot:
    tags: profiling
    extra_configs:
      - CONFIG_TRACING_BUFFER_SIZE=4096
      - CONFIG_ZPL_TRACE_FORMAT_CTF=y
      - CONFIG_BOOT_BANNER=n
      - CONFIG_PRINTK=n
    harness: robot
    harness_config:
      robot_testsuite: cpu_load_ctf.robot
```

## samples/trace/die_temp/sample.yaml
```yaml
sample:
  name: simple
common:
  tags: profiling
  platform_allow:
    - stm32f429i_disc1/stm32f429xx
  harness: console
  harness_config:
    type: one_line
    regex:
      - "zpl_die_temp_event: die_temp\\[0\\]=[0-9]+\\.[0-9]+"
tests:
  sample.trace.die_temp.plaintext:
    tags: profiling
  sample.trace.die_temp.plaintext.robot:
    tags: profiling
    harness: robot
    harness_config:
      robot_testsuite: die_temp_plaintext.robot
  sample.trace.die_temp.ctf.robot:
    tags: profiling
    extra_configs:
      - CONFIG_ZPL_TRACE_FORMAT_CTF=y
      - CONFIG_BOOT_BANNER=n
      - CONFIG_PRINTK=n
    harness: robot
    harness_config:
      robot_testsuite: die_temp_ctf.robot
```

## samples/trace/named_event/sample.yaml
```yaml
sample:
  name: simple
common:
  tags: profiling
  harness: console
  harness_config:
    type: one_line
    regex:
      - "zpl_named_event"
tests:
  sample.trace.named_event.plaintext:
    tags: profiling
  sample.trace.named_event.plaintext.robot:
    tags: profiling
    harness: robot
    harness_config:
      robot_testsuite: named_event_plaintext.robot
  sample.trace.named_event.ctf.robot:
    tags: profiling
    extra_configs:
      - CONFIG_TRACING_BUFFER_SIZE=4096
      - CONFIG_ZPL_TRACE_FORMAT_CTF=y
      - CONFIG_BOOT_BANNER=n
      - CONFIG_PRINTK=n
    harness: robot
    harness_config:
      robot_testsuite: named_event_ctf.robot
  sample.trace.named_event.trivial_uart.robot:
    tags: profiling
    platform_allow:
      - max78002evkit/max78002/m4
    extra_configs:
      - CONFIG_ZPL_TRACE_BACKEND_TRIVIAL_UART=y
    harness: robot
    harness_config:
      robot_testsuite: named_event_plaintext_trivial_uart.robot
  sample.trace.named_event.usb:
    tags: profiling
    platform_allow:
      - stm32f429i_disc1/stm32f429xx
    build_only: true
    extra_configs:
      - CONFIG_ZPL_TRACE_BACKEND_USB=y
  sample.trace.named_event.debugger:
    tags: profiling
    extra_configs:
      - CONFIG_ZPL_TRACE_BACKEND_DEBUGGER=y
      - CONFIG_RAM_TRACING_BUFFER_SIZE=10240
    harness: robot
    harness_config:
      robot_testsuite: named_event_plaintext_debugger.robot
```

## samples/trace/tflm_profiler/sample.yaml
```yaml
# Copyright (c) 2025 Analog Devices, Inc.
# Copyright (c) 2025 Antmicro <www.antmicro.com>
#
# SPDX-License-Identifier: Apache-2.0

sample:
  name: simple
common:
  tags: profiling
  harness: console
  harness_config:
    type: one_line
    regex:
      - "zpl_tflm_enter_event: subgraph_idx=0 op_idx=0 tag=CONV_2D"
      - "zpl_tflm_exit_event: subgraph_idx=0 op_idx=0 tag=CONV_2D"
tests:
  sample.trace.tflm_profiler.plaintext:
    tags: profiling
  sample.trace.tflm_profiler.plaintext.robot:
    tags: profiling
    harness: robot
    harness_config:
      robot_testsuite: tflm_plaintext.robot
  sample.trace.tflm_profiler.ctf.robot:
    tags: profiling
    extra_configs:
      - CONFIG_TRACING_BUFFER_SIZE=4096
      - CONFIG_ZPL_TRACE_FORMAT_CTF=y
      - CONFIG_BOOT_BANNER=n
      - CONFIG_PRINTK=n
    harness: robot
    harness_config:
      robot_testsuite: tflm_ctf.robot
```

## samples/trace/tiers/sample.yaml
```yaml
sample:
  name: simple
common:
  tags: profiling
tests:
  sample.trace.tiers.plaintext.minimal:
    harness: console
    extra_configs:
      - CONFIG_ZPL_TRACE_MINIMAL_MODE=y
    harness_config:
      type: one_line
      regex:
        - "zpl_inference_enter:"
        - "zpl_inference_exit:"
        - "zpl_memory_event:"
  sample.trace.tiers.plaintext.layer_profiling:
    harness: console
    extra_configs:
      - CONFIG_ZPL_TRACE_LAYER_PROFILING_MODE=y
    harness_config:
      type: one_line
      regex:
        - "zpl_inference_enter:"
        - "zpl_tflm_enter_event: subgraph_idx=0 op_idx=0 tag=CONV_2D"
        - "zpl_tflm_exit_event: subgraph_idx=0 op_idx=0 tag=CONV_2D"
        - "zpl_tflm_enter_event: subgraph_idx=0 op_idx=1 tag=MAX_POOL_2D"
        - "zpl_tflm_exit_event: subgraph_idx=0 op_idx=1 tag=MAX_POOL_2D"
        - "zpl_tflm_enter_event: subgraph_idx=0 op_idx=2 tag=CONV_2D"
        - "zpl_tflm_exit_event: subgraph_idx=0 op_idx=2 tag=CONV_2D"
        - "zpl_tflm_enter_event: subgraph_idx=0 op_idx=3 tag=MAX_POOL_2D"
        - "zpl_tflm_exit_event: subgraph_idx=0 op_idx=3 tag=MAX_POOL_2D"
        - "zpl_tflm_enter_event: subgraph_idx=0 op_idx=4 tag=RESHAPE"
        - "zpl_tflm_exit_event: subgraph_idx=0 op_idx=4 tag=RESHAPE"
        - "zpl_tflm_enter_event: subgraph_idx=0 op_idx=5 tag=FULLY_CONNECTED"
        - "zpl_tflm_exit_event: subgraph_idx=0 op_idx=5 tag=FULLY_CONNECTED"
        - "zpl_tflm_enter_event: subgraph_idx=0 op_idx=6 tag=FULLY_CONNECTED"
        - "zpl_tflm_exit_event: subgraph_idx=0 op_idx=6 tag=FULLY_CONNECTED"
        - "zpl_tflm_enter_event: subgraph_idx=0 op_idx=7 tag=SOFTMAX"
        - "zpl_tflm_exit_event: subgraph_idx=0 op_idx=7 tag=SOFTMAX"
        - "zpl_inference_exit:"
        - "zpl_memory_event"
  sample.trace.tiers.plaintext.full:
    harness: console
    extra_configs:
      - CONFIG_ZPL_TRACE_FULL_MODE=y
    harness_config:
      type: one_line
      regex:
        - "zpl_inference_enter:"
        - "zpl_tflm_enter_event: subgraph_idx=0 op_idx=0 tag=CONV_2D"
        - "zpl_tflm_exit_event: subgraph_idx=0 op_idx=0 tag=CONV_2D"
        - "zpl_tflm_enter_event: subgraph_idx=0 op_idx=1 tag=MAX_POOL_2D"
        - "zpl_tflm_exit_event: subgraph_idx=0 op_idx=1 tag=MAX_POOL_2D"
        - "zpl_tflm_enter_event: subgraph_idx=0 op_idx=2 tag=CONV_2D"
        - "zpl_tflm_exit_event: subgraph_idx=0 op_idx=2 tag=CONV_2D"
        - "zpl_tflm_enter_event: subgraph_idx=0 op_idx=3 tag=MAX_POOL_2D"
        - "zpl_tflm_exit_event: subgraph_idx=0 op_idx=3 tag=MAX_POOL_2D"
        - "zpl_tflm_enter_event: subgraph_idx=0 op_idx=4 tag=RESHAPE"
        - "zpl_tflm_exit_event: subgraph_idx=0 op_idx=4 tag=RESHAPE"
        - "zpl_tflm_enter_event: subgraph_idx=0 op_idx=5 tag=FULLY_CONNECTED"
        - "zpl_tflm_exit_event: subgraph_idx=0 op_idx=5 tag=FULLY_CONNECTED"
        - "zpl_tflm_enter_event: subgraph_idx=0 op_idx=6 tag=FULLY_CONNECTED"
        - "zpl_tflm_exit_event: subgraph_idx=0 op_idx=6 tag=FULLY_CONNECTED"
        - "zpl_tflm_enter_event: subgraph_idx=0 op_idx=7 tag=SOFTMAX"
        - "zpl_tflm_exit_event: subgraph_idx=0 op_idx=7 tag=SOFTMAX"
        - "zpl_inference_exit:"
        - "sys_trace_isr_enter"
        - "sys_trace_isr_exit"
        - "zpl_memory_event"
  sample.trace.tiers.plaintext.minimal.robot:
    harness: robot
    extra_configs:
      - CONFIG_ZPL_TRACE_MINIMAL_MODE=y
    harness_config:
      robot_testsuite: plaintext_minimal.robot
  sample.trace.tiers.plaintext.layer_profiling.robot:
    harness: robot
    extra_configs:
      - CONFIG_ZPL_TRACE_LAYER_PROFILING_MODE=y
    harness_config:
      robot_testsuite: plaintext_layer_profiling.robot
  sample.trace.tiers.plaintext.full.robot:
    harness: robot
    extra_configs:
      - CONFIG_ZPL_TRACE_FULL_MODE=y
    harness_config:
      robot_testsuite: plaintext_full.robot
  sample.trace.tiers.ctf.minimal.robot:
    harness: robot
    extra_configs:
      - CONFIG_ZPL_TRACE_MINIMAL_MODE=y
      - CONFIG_ZPL_TRACE_FORMAT_CTF=y
      - CONFIG_BOOT_BANNER=n
      - CONFIG_PRINTK=n
    harness_config:
      robot_testsuite: ctf_minimal.robot
  sample.trace.tiers.ctf.layer_profiling.robot:
    harness: robot
    extra_configs:
      - CONFIG_ZPL_TRACE_LAYER_PROFILING_MODE=y
      - CONFIG_ZPL_TRACE_FORMAT_CTF=y
      - CONFIG_BOOT_BANNER=n
      - CONFIG_PRINTK=n
    harness_config:
      robot_testsuite: ctf_layer_profiling.robot
  sample.trace.tiers.ctf.full.robot:
    harness: robot
    extra_configs:
      - CONFIG_ZPL_TRACE_FULL_MODE=y
      - CONFIG_ZPL_TRACE_FORMAT_CTF=y
      - CONFIG_BOOT_BANNER=n
      - CONFIG_PRINTK=n
    harness_config:
      robot_testsuite: ctf_full.robot
```

## samples/trace/tvm_profiler/sample.yaml
```yaml
sample:
  name: simple
common:
  tags: profiling
  harness: console
  harness_config:
    type: one_line
    regex:
      - "zpl_tvm_enter_event: op_idx=3 tag=tvmgen_default_fused_nn_conv2d_add_nn_relu"
      - "zpl_tvm_exit_event: op_idx=3 tag=tvmgen_default_fused_nn_conv2d_add_nn_relu"
tests:
  sample.trace.tvm_profiler.plaintext:
    tags: profiling
  sample.trace.tvm_profiler.plaintext.robot:
    tags: profiling
    harness: robot
    harness_config:
      robot_testsuite: tvm_profiler_plaintext.robot
  sample.trace.tvm_profiler.ctf.robot:
    tags: profiling
    extra_configs:
      - CONFIG_TRACING_BUFFER_SIZE=4096
      - CONFIG_ZPL_TRACE_FORMAT_CTF=y
      - CONFIG_BOOT_BANNER=n
      - CONFIG_PRINTK=n
    harness: robot
    harness_config:
      robot_testsuite: tvm_profiler_ctf.robot
```

## tests/lib/basic/testcase.yaml
```yaml
# Copyright (c) 2025 Analog Devices, Inc.
# Copyright (c) 2025 Antmicro <www.antmicro.com>
#
# SPDX-License-Identifier: Apache-2.0

common:
  tags: profiling
  integration_platforms:
    - qemu_cortex_m0
tests:
  zpl.lib.init: {}
  zpl.lib.init.usb:
    extra_args:
      - EXTRA_CFLAGS=-DCONFIG_ZPL_TRACE_BACKEND_USB=y
  zpl.lib.runtime_conf.none.on:
    extra_args:
      - EXTRA_CFLAGS=-DCONFIG_ZPL_TRACE_BACKEND_USB=y
  zpl.lib.runtime_conf.none.off:
    extra_args:
      - EXTRA_CFLAGS=-DCONFIG_ZPL_TRACE_BACKEND_USB=n
  zpl.lib.runtime_conf.uart.on:
    extra_args:
      - EXTRA_CFLAGS=-DCONFIG_ZPL_RUNTIME_CONFIG_UART=y -DCONFIG_ZPL_TRACE_BACKEND_USB=y
  zpl.lib.runtime_conf.uart.off:
    extra_args:
      - EXTRA_CFLAGS=-DCONFIG_ZPL_RUNTIME_CONFIG_UART=y -DCONFIG_ZPL_TRACE_BACKEND_USB=n
```

## tests/lib/usb/testcase.yaml
```yaml
# Copyright (c) 2025 Analog Devices, Inc.
# Copyright (c) 2025 Antmicro <www.antmicro.com>
#
# SPDX-License-Identifier: Apache-2.0

common:
  tags: profiling
  platform_allow:
    - stm32f429i_disc1/stm32f429xx
tests:
  zpl.usb.test: {}
```

## zpl/conf/Kconfig
```kconfig
# Copyright (c) 2025 Analog Devices, Inc.
# Copyright (c) 2025 Antmicro <www.antmicro.com>
#
# SPDX-License-Identifier: Apache-2.0

choice
	prompt "Zpl runtime configuration method"
	default ZPL_RUNTIME_CONFIG_NONE

config ZPL_RUNTIME_CONFIG_NONE
	bool "No runtime configuration"

config ZPL_RUNTIME_CONFIG_UART
	bool "Runtime configuration via UART"
	select SHELL
	select SHELL_MINIMAL

config ZPL_RUNTIME_CONFIG_DEBUG
	bool "Runtime configuration via debug flags"

endchoice

config ZPL_MEMORY_USAGE_TRACE
	bool "Enables memory usage traces"

choice
	prompt "Zeppelin trace mode"
	default ZPL_TRACE_LAYER_PROFILING_MODE
	depends on ZPL_TRACE

config ZPL_TRACE_MINIMAL_MODE
	bool "Extremely lightweight profiling mode with no persistent trace"
	imply ZPL_INFERENCE_PROFILING
	imply ZPL_MEMORY_USAGE_TRACE

config ZPL_TRACE_LAYER_PROFILING_MODE
	bool "Layer-level timing with optional runtime hooks"
	imply ZPL_INFERENCE_PROFILING
	imply ZPL_MEMORY_USAGE_TRACE

config ZPL_TRACE_FULL_MODE
	bool "Full profiling mode that enables complete CTF tracing"
	imply ZPL_INFERENCE_PROFILING
	imply ZPL_MEMORY_USAGE_TRACE
	imply TRACING_SYSCALL
	imply TRACING_THREAD
	imply TRACING_WORK
	imply TRACING_ISR
	imply TRACING_SEMAPHORE
	imply TRACING_MUTEX
	imply TRACING_CONDVAR
	imply TRACING_QUEUE
	imply TRACING_FIFO
	imply TRACING_LIFO
	imply TRACING_STACK
	imply TRACING_MESSAGE_QUEUE
	imply TRACING_MAILBOX
	imply TRACING_PIPE
	imply TRACING_HEAP
	imply TRACING_MEMORY_SLAB
	imply TRACING_TIMER
	imply TRACING_EVENT
	imply TRACING_POLLING
	imply TRACING_PM
	imply TRACING_NETWORKING
	imply TRACING_NET_SOCKETS
	imply TRACING_NET_CORE
	imply TRACING_GPIO
	imply TRACING_IDLE

endchoice
```

## zpl/conf/Kconfig.mute_traces
```kconfig
# Copyright (c) 2025 Analog Devices, Inc.
# Copyright (c) 2025 Antmicro <www.antmicro.com>
#
# SPDX-License-Identifier: Apache-2.0

config TRACING_SYSCALL
	default n

config TRACING_THREAD
	default n

config TRACING_WORK
	default n

config TRACING_ISR
	default n

config TRACING_SEMAPHORE
	default n

config TRACING_MUTEX
	default n

config TRACING_CONDVAR
	default n

config TRACING_QUEUE
	default n

config TRACING_FIFO
	default n

config TRACING_LIFO
	default n

config TRACING_STACK
	default n

config TRACING_MESSAGE_QUEUE
	default n

config TRACING_MAILBOX
	default n

config TRACING_PIPE
	default n

config TRACING_HEAP
	default n

config TRACING_MEMORY_SLAB
	default n

config TRACING_TIMER
	default n

config TRACING_EVENT
	default n

config TRACING_POLLING
	default n

config TRACING_PM
	default n

config TRACING_NETWORKING
	default n

config TRACING_NET_SOCKETS
	default n

config TRACING_NET_CORE
	default n

config TRACING_GPIO
	default n

config TRACING_IDLE
	default n
```
