## zpl/profilers/Kconfig
```kconfig
# Copyright (c) 2025 Analog Devices, Inc.
# Copyright (c) 2025 Antmicro <www.antmicro.com>
#
# SPDX-License-Identifier: Apache-2.0

rsource "memory/Kconfig"
rsource "cpu/Kconfig"
rsource "inference/Kconfig"
rsource "tvm/Kconfig"
rsource "tflm/Kconfig"
```

## zpl/profilers/cpu/Kconfig
```kconfig
# Copyright (c) 2025 Analog Devices, Inc.
# Copyright (c) 2025 Antmicro <www.antmicro.com>
#
# SPDX-License-Identifier: Apache-2.0

config ZPL_CPU_LOAD_PROFILING
	bool "CPU load profiling"
	depends on ZPL
	depends on CPU_LOAD
	select INIT_STACKS
	help
	  Say 'Y' if you want to enable support for the CPU load profiling.

config ZPL_CPU_LOAD_PROFILING_INTERVAL
	int "CPU load profiling interval in milliseconds"
	default 1000
	depends on ZPL_CPU_LOAD_PROFILING

config ZPL_CPU_LOAD_PROFILING_THREAD_STACK_SIZE
	int "CPU load profiling thread stack size in bytes"
	default 512
	depends on ZPL_CPU_LOAD_PROFILING

config ZPL_CPU_LOAD_PROFILING_THREAD_PRIORITY
	int "CPU load profiling thread priority"
	default 5
	depends on ZPL_CPU_LOAD_PROFILING

config ZPL_CPU_LOAD_PROFILING_THREAD_DELAY
	int "CPU load profiling thread delay"
	default 0
	depends on ZPL_CPU_LOAD_PROFILING

config ZPL_CPU_LOAD_TRACE
	bool "Enables CPU load traces"

config ZPL_DIE_TEMP_PROFILING
	bool "DIE temperature profiling"
	depends on ZPL
	depends on ADC
	depends on SENSOR
	select INIT_STACKS
	help
	  Say 'Y' if you want to enable support for the DIE temperature profiling.

config ZPL_DIE_TEMP_PROFILING_SENSORS_COUNT
	int "Number of DIE temperature sensors to use for profiling"
	default 2
	depends on ZPL_DIE_TEMP_PROFILING

config ZPL_DIE_TEMP_PROFILING_INTERVAL
	int "DIE temperature profiling interval in milliseconds"
	default 1000
	depends on ZPL_DIE_TEMP_PROFILING

config ZPL_DIE_TEMP_PROFILING_THREAD_STACK_SIZE
	int "DIE temperature profiling thread stack size in bytes"
	default 512
	depends on ZPL_DIE_TEMP_PROFILING

config ZPL_DIE_TEMP_PROFILING_THREAD_PRIORITY
	int "DIE temperature profiling thread priority"
	default 5
	depends on ZPL_DIE_TEMP_PROFILING

config ZPL_DIE_TEMP_PROFILING_THREAD_DELAY
	int "DIE temperature profiling thread delay"
	default 0
	depends on ZPL_DIE_TEMP_PROFILING

config ZPL_DIE_TEMP_TRACE
	bool "Enables DIE temperature traces"
```

## zpl/profilers/inference/Kconfig
```kconfig
# Copyright (c) 2025 Analog Devices, Inc.
# Copyright (c) 2025 Antmicro <www.antmicro.com>
#
# SPDX-License-Identifier: Apache-2.0

config ZPL_INFERENCE_PROFILING
	bool "Build with inference profiling support"
```

## zpl/profilers/memory/Kconfig
```kconfig
# Copyright (c) 2025 Analog Devices, Inc.
# Copyright (c) 2025 Antmicro <www.antmicro.com>
#
# SPDX-License-Identifier: Apache-2.0

config ZPL_MEMORY_PROFILING
	bool "Memory profiling"
	depends on ZPL
	depends on SYS_HEAP_ARRAY_SIZE > 0
	select SYS_HEAP_RUNTIME_STATS
	select THREAD_STACK_INFO
	select THREAD_MONITOR
	select INIT_STACKS
	help
	  Say 'Y' if you want to enable support for the Memory Profiling.

config ZPL_MEMORY_PROFILING_INTERVAL
	int "Memory profiling interval in milliseconds"
	default 1000
	depends on ZPL_MEMORY_PROFILING

config ZPL_MEMORY_PROFILING_THREAD_STACK_SIZE
	int "Memory profiling thread stack size in bytes"
	default 512
	depends on ZPL_MEMORY_PROFILING

config ZPL_MEMORY_PROFILING_THREAD_PRIORITY
	int "Memory profiling thread priority"
	default 5
	depends on ZPL_MEMORY_PROFILING

config ZPL_MEMORY_PROFILING_THREAD_DELAY
	int "Memory profiling thread delay"
	default 0
	depends on ZPL_MEMORY_PROFILING
```

## zpl/profilers/tflm/Kconfig
```kconfig
# Copyright (c) 2025 Analog Devices, Inc.
# Copyright (c) 2025 Antmicro <www.antmicro.com>
#
# SPDX-License-Identifier: Apache-2.0

config ZPL_TFLM_EVENTS
	bool "Enables TFLite Micro events"
	depends on ZPL

config ZPL_TFLM_PROFILER
	bool "Build with TFLM profiler support"
	depends on ZPL_TFLM_EVENTS
	depends on TENSORFLOW_LITE_MICRO
	depends on CPP
	depends on STD_CPP17

config ZPL_TFLM_PROFILER_MAX_EVENTS
	int "Maximum number of stored events"
	default 32
	depends on ZPL_TFLM_PROFILER
```

## zpl/scopes/Kconfig
```kconfig
# Copyright (c) 2025 Analog Devices, Inc.
# Copyright (c) 2025 Antmicro <www.antmicro.com>
#
# SPDX-License-Identifier: Apache-2.0

config ZPL_SCOPE_MARKING
	bool "Scope entry and leaving marking"
	depends on ZPL
```
