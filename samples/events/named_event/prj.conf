## CMakeLists.txt
```
# Copyright (c) 2025 Analog Devices, Inc.
# Copyright (c) 2025 Antmicro <www.antmicro.com>
#
# SPDX-License-Identifier: Apache-2.0

cmake_minimum_required(VERSION 3.20.0)

include(${CMAKE_CURRENT_SOURCE_DIR}/../../common/boards.cmake)

find_package(Zephyr REQUIRED HINTS $ENV{ZEPHYR_BASE})
project(app)

if(CONFIG_CPP)
  set_source_files_properties(src/main.c PROPERTIES LANGUAGE CXX)
endif()

target_sources(app PRIVATE src/main.c)
```

## sample.yaml
```
# Copyright (c) 2025 Analog Devices, Inc.
# Copyright (c) 2025 Antmicro <www.antmicro.com>
#
# SPDX-License-Identifier: Apache-2.0

sample:
  name: named_event
common:
  tags: events
  platform_exclude:
    - mpfs_icicle/polarfire/u54/smp
tests:
  sample.trace.named_event.plaintext:
    harness: console
    harness_config:
      type: one_line
      regex:
        - "zpl_named_event"
  sample.trace.named_event.plaintext.cpp:
    harness: console
    harness_config:
      type: one_line
      regex:
        - "zpl_named_event"
    extra_configs:
      - CONFIG_CPP=y
  sample.trace.named_event.plaintext.robot:
    harness: robot
    harness_config:
      robot_testsuite: named_event_plaintext.robot
  sample.trace.named_event.plaintext.cpp.robot:
    harness: robot
    harness_config:
      robot_testsuite: named_event_plaintext.robot
    extra_configs:
      - CONFIG_CPP=y
  sample.trace.named_event.ctf.robot:
    extra_configs:
      - CONFIG_TRACING_BUFFER_SIZE=4096
      - CONFIG_ZPL_TRACE_FORMAT_CTF=y
      - CONFIG_BOOT_BANNER=n
      - CONFIG_PRINTK=n
    harness: robot
    harness_config:
      robot_testsuite: named_event_ctf.robot
  sample.trace.named_event.ctf.cpp.robot:
    extra_configs:
      - CONFIG_TRACING_BUFFER_SIZE=4096
      - CONFIG_ZPL_TRACE_FORMAT_CTF=y
      - CONFIG_BOOT_BANNER=n
      - CONFIG_PRINTK=n
      - CONFIG_CPP=y
    harness: robot
    harness_config:
      robot_testsuite: named_event_ctf.robot
  sample.trace.named_event.trivial_uart.robot:
    platform_allow:
      - max78002evkit/max78002/m4
    extra_configs:
      - CONFIG_ZPL_TRACE_BACKEND_TRIVIAL_UART=y
    harness: robot
    harness_config:
      robot_testsuite: named_event_plaintext_trivial_uart.robot
  sample.trace.named_event.trivial_uart.cpp.robot:
    platform_allow:
      - max78002evkit/max78002/m4
    extra_configs:
      - CONFIG_ZPL_TRACE_BACKEND_TRIVIAL_UART=y
      - CONFIG_CPP=y
    harness: robot
    harness_config:
      robot_testsuite: named_event_plaintext_trivial_uart.robot
  sample.trace.named_event.usb:
    platform_allow:
      - stm32f429i_disc1/stm32f429xx
    build_only: true
    extra_configs:
      - CONFIG_ZPL_TRACE_BACKEND_USB=y
  sample.trace.named_event.usb.cpp:
    platform_allow:
      - stm32f429i_disc1/stm32f429xx
    build_only: true
    extra_configs:
      - CONFIG_ZPL_TRACE_BACKEND_USB=y
      - CONFIG_CPP=y
  sample.trace.named_event.debugger:
    extra_configs:
      - CONFIG_ZPL_TRACE_BACKEND_DEBUGGER=y
      - CONFIG_RAM_TRACING_BUFFER_SIZE=10240
    harness: robot
    harness_config:
      robot_testsuite: named_event_plaintext_debugger.robot
  sample.trace.named_event.debugger.cpp:
    extra_configs:
      - CONFIG_ZPL_TRACE_BACKEND_DEBUGGER=y
      - CONFIG_RAM_TRACING_BUFFER_SIZE=10240
    harness: robot
    harness_config:
      robot_testsuite: named_event_plaintext_debugger.robot
```

## prj.conf
```kconfig
CONFIG_ZPL=y
CONFIG_ZPL_TRACE=y
```

## src/main.c
```c
/*
 * Copyright (c) 2025 Analog Devices, Inc.
 * Copyright (c) 2025 Antmicro <www.antmicro.com>
 *
 * SPDX-License-Identifier: Apache-2.0
 */

#include <zephyr/kernel.h>
#include <zpl.h>

int main(void)
{
	for (int i = 0; i < 100; i++) {
		sys_trace_named_event("counter_value", i, 0);
		k_sleep(K_SECONDS(1));
	}

	return 0;
}
```
